## CMakeLists.txt
```
cmake_minimum_required(VERSION 3.20.0)
find_package(Zephyr REQUIRED HINTS $ENV{ZEPHYR_BASE})
project(rpmsg_r5_1)

# R5_1 (2 コア目)。起動の仕組みは apps/rpmsg_r5 と同じで、リンカの工夫 (linker.ld / rsc_table.ld) もそちらを使う
target_include_directories(app PRIVATE ${LIBMETAL_INCLUDE_DIR} ${OPENAMP_INCLUDE_DIR} ${PLATFORM_DIR})
target_sources(app PRIVATE src/main.c src/r51_audio.c ${CMAKE_CURRENT_SOURCE_DIR}/../rpmsg_r5/src/synth.c)

zephyr_linker_sources(RAM_SECTIONS ${CMAKE_CURRENT_SOURCE_DIR}/../rpmsg_r5/rsc_table.ld)

# R5_0 と R5_1 の取り決め (apps/common/r2r_shm.h)。音を作る部分は R5_0 の synth.c を共用する
target_include_directories(app PRIVATE ${CMAKE_CURRENT_SOURCE_DIR}/../common ${CMAKE_CURRENT_SOURCE_DIR}/../rpmsg_r5/src)
```

## prj.conf
```kconfig
# R5_1 (2 コア目) 用。apps/rpmsg_r5 (R5_0) との違いは UART を使わないことと窓口の番号
CONFIG_IPM=y
CONFIG_OPENAMP=y
CONFIG_OPENAMP_RSC_TABLE=y
CONFIG_OPENAMP_RSC_TABLE_NUM_RPMSG_BUFF=8
CONFIG_OPENAMP_MASTER=n
CONFIG_HEAP_MEM_POOL_SIZE=1024
CONFIG_MAIN_STACK_SIZE=1024

# UART は使わない (Linux のコンソール UART1 の割り込みを止めてしまうため)。表示は shell (RPMsg) だけ
CONFIG_SERIAL=n
CONFIG_CONSOLE=n
CONFIG_UART_CONSOLE=n
CONFIG_PRINTK=n

# shell は RPMsg に載せる。R5_0 の shell (0x440) と区別するため 0x441
CONFIG_SHELL=y
CONFIG_SHELL_BACKEND_RPMSG=y
CONFIG_SHELL_RPMSG_SERVICE_NAME="rpmsg-raw"
CONFIG_SHELL_RPMSG_SRC_ADDR=0x441
CONFIG_SHELL_BACKEND_SERIAL=n
CONFIG_KERNEL_SHELL=y
CONFIG_THREAD_MONITOR=y
CONFIG_THREAD_NAME=y

# コードは ATCM、変数は BTCM (R5_0 と同じ。リンカは apps/rpmsg_r5/linker.ld)
CONFIG_XIP=y
CONFIG_HAVE_CUSTOM_LINKER_SCRIPT=y
CONFIG_CUSTOM_LINKER_SCRIPT="../rpmsg_r5/linker.ld"

# R5_0 と割り込みコントローラ (GIC) を共用する (apps/rpmsg_r5/prj.conf の説明を参照)
CONFIG_GIC_SAFE_CONFIG=y
```

## src/main.c
```c
// -----------------------------------------------------------------------------
// main.c -- R5_1 (2 コア目) の Zephyr。Linux の remoteproc から起動され、RPMsg で話す
//
//   R5_0 (apps/rpmsg_r5) は音・CNN など PL を使う時間に正確な仕事、R5_1 は重い計算を受け持つ。
//   2 つのコアは独立しているので、R5_1 が 100% 計算していても R5_0 の音は乱れない (それを測る)。
//
//   窓口 (名前はどれも rpmsg-raw。番号は R5_0 と重ならないようにする。R5 側で使えるのは 0x400〜0x47F)
//     0x401  エコー: "R5_1: " を付けて送り返す (linux/rpmsg_rtt.py で往復を測る)
//     0x441  shell (prj.conf。linux/r5_shell.sh 1089 でつなぐ)
//     0x450  計算役: n 以下の素数を割り算で数え、かかった時間を返す (linux/r5_1_calc.py)
//     0x460  音の分業: 音を作ってリバーブを掛け、R5_0 と共有の輪バッファに書く (r51_audio.c)
//       依頼  u32 magic = 0x434C4143 ("CALC")  u32 seq  u32 n
//       返事  u32 magic = 0x524C4143 ("CALR")  u32 seq  u32 n  u32 count  u32 us
//
//   起動の流れ (platform_init / create_vdev) は apps/rpmsg_r5/src/main.c と同じ。違いは
//   共有メモリと IPI の番地 (rpmsg_r5_1.overlay) と、UART を使わないこと。
// -----------------------------------------------------------------------------
#include <zephyr/kernel.h>
#include <zephyr/device.h>
#include <zephyr/drivers/ipm.h>
#include <zephyr/shell/shell.h>
#include <zephyr/shell/shell_rpmsg.h>
#include <string.h>

#include <openamp/open_amp.h>
#include <metal/sys.h>
#include <metal/io.h>
#include <resource_table.h>
#include <addr_translation.h>

#include "r2r_shm.h"
#include "ipi_early_clear.h"

/* 前回の R5_1 が残した IPI の合図で起動が止まらないよう、割り込み解禁前に消す (ipi_early_clear.h) */
IPI_EARLY_CLEAR(DT_NODELABEL(rpu1_ipi));

void r51_audio_kick(void);                         /* r51_audio.c */
int r51_audio_init(struct rpmsg_device *rpdev);    /* r51_audio.c */

#define SHM_NODE       DT_CHOSEN(zephyr_ipc_shm)
#define SHM_START_ADDR DT_REG_ADDR(SHM_NODE)
#define SHM_SIZE       DT_REG_SIZE(SHM_NODE)

#define EPT_NAME  "rpmsg-raw"
#define ECHO_ADDR 0x401
#define CALC_ADDR 0x450

#define MAGIC_REQ 0x434C4143u   /* "CALC" */
#define MAGIC_RES 0x524C4143u   /* "CALR" */

static const struct device *const ipm = DEVICE_DT_GET(DT_CHOSEN(zephyr_ipc));

static metal_phys_addr_t shm_physmap = SHM_START_ADDR;
static metal_phys_addr_t rsc_tab_physmap;
static struct metal_io_region shm_io_data;
static struct metal_io_region rsc_io_data;
static struct rpmsg_virtio_device rvdev;
static void *rsc_table;

static struct rpmsg_endpoint echo_ept, calc_ept;
static uint32_t n_echo;

static K_SEM_DEFINE(ipi_sem, 0, 1);

static void ipm_cb(const struct device *dev, void *ctx, uint32_t id, volatile void *data)
{
	k_sem_give(&ipi_sem);
}

static int mailbox_notify(void *priv, uint32_t id)
{
	ipm_send(ipm, 0, id, &id, sizeof(id));
	return 0;
}

/* ---- エコー ---- */
static int echo_cb(struct rpmsg_endpoint *e, void *data, size_t len, uint32_t src, void *priv)
{
	static char tx[RPMSG_BUFFER_SIZE];
	size_t n = MIN(len, sizeof(tx) - 6);

	memcpy(tx, "R5_1: ", 6);
	memcpy(tx + 6, data, n);
	n_echo++;
	rpmsg_send(e, tx, n + 6);
	return RPMSG_SUCCESS;
}

/* ---- 計算役: 受信は依頼を受け取るだけ。計算は別スレッド (管理スレッドを止めないため) ---- */
struct calc_req {
	uint32_t magic, seq, n;
} __packed;

struct calc_res {
	uint32_t magic, seq, n, count, us;
} __packed;

static struct calc_req req;
static K_SEM_DEFINE(calc_sem, 0, 1);
static uint32_t n_calc, n_bad;
static uint64_t calc_sum_us;

static int calc_cb(struct rpmsg_endpoint *e, void *data, size_t len, uint32_t src, void *priv)
{
	const struct calc_req *q = data;

	if (len != sizeof(*q) || q->magic != MAGIC_REQ || k_sem_count_get(&calc_sem)) {
		n_bad++;
		return RPMSG_SUCCESS;
	}
	req = *q;
	k_sem_give(&calc_sem);
	return RPMSG_SUCCESS;
}

/* n 以下の素数の数 (奇数で割っていくだけ。わざと重い計算) */
static uint32_t count_primes(uint32_t n)
{
	uint32_t c = n >= 2;

	for (uint32_t m = 3; m <= n; m += 2) {
		bool prime = true;

		for (uint32_t d = 3; d * d <= m; d += 2) {
			if (m % d == 0) {
				prime = false;
				break;
			}
		}
		c += prime;
	}
	return c;
}

static void calc_thread(void *a, void *b, void *c)
{
	for (;;) {
		k_sem_take(&calc_sem, K_FOREVER);
		struct calc_res r = {.magic = MAGIC_RES, .seq = req.seq, .n = req.n};
		uint32_t c0 = k_cycle_get_32();

		r.count = count_primes(req.n);
		r.us = (uint32_t)((uint64_t)(k_cycle_get_32() - c0) * 1000000U /
				  sys_clock_hw_cycles_per_sec());
		n_calc++;
		calc_sum_us += r.us;
		rpmsg_send(&calc_ept, &r, sizeof(r));
	}
}
/* 優先度は低め (7)。計算中も shell と通信は動く */
K_THREAD_DEFINE(calc_tid, 1024, calc_thread, NULL, NULL, NULL, 7, 0, 0);

/* ---- R5_0 からの直接の IPI (Linux を通さない。R5_0 の r2r.c と対、形は apps/common/r2r_shm.h) ----
 * 割り込みの中で呼ばれる。PING はそのまま返し、KICK は音を作るスレッドを起こす。
 * data はドライバ内の struct xlnx_ipi_data。中身は先頭から 8 バイト目 (r2r.c の説明)
 */
static const struct device *const r2r = DEVICE_DT_GET(DT_NODELABEL(rpu1_rpu0_mailbox));
static uint32_t n_r2r;

static void r2r_cb(const struct device *dev, void *ctx, uint32_t id, volatile void *data)
{
	const volatile struct r2r_msg *m = (const volatile struct r2r_msg *)((volatile uint8_t *)data + 8);

	n_r2r++;
	/* Zephyr の IPI ドライバは ISR のビットを「読んで OR して書き戻す」で消すため、この合図を消す時に
	 * 同時に来ていた Linux の合図 (APU のビット) まで消してしまう (W1C のレジスタ)。KICK は 1ms ごとに
	 * 来るので実際に起きた (段B で Linux の命令が 15 個目で止まった)。消されても取りこぼさないよう、
	 * ここで毎回 main に受信リングを見に行かせる (何も無ければ空振りするだけ)
	 */
	k_sem_give(&ipi_sem);
	if (m->type == R2R_PING) {   /* 往復の測定: そのまま返す */
		struct r2r_msg back = {R2R_PING, m->val};

		ipm_send(r2r, 0, 0, &back, sizeof(back));
	} else if (m->type == R2R_KICK) {   /* 輪バッファを読んだので足して (r51_audio.c) */
		r51_audio_kick();
	}
}

static int platform_init(void)
{
	struct metal_init_params mp = METAL_INIT_DEFAULTS;
	int rsc_size;

	if (metal_init(&mp)) {
		return -1;
	}
	metal_io_init(&shm_io_data, (void *)SHM_START_ADDR, &shm_physmap, SHM_SIZE, -1, 0,
		      addr_translation_get_ops(shm_physmap));

	rsc_table_get(&rsc_table, &rsc_size);
	rsc_tab_physmap = (uintptr_t)rsc_table;
	metal_io_init(&rsc_io_data, rsc_table, &rsc_tab_physmap, rsc_size, -1, 0, NULL);

	if (!device_is_ready(ipm)) {
		return -2;
	}
	ipm_register_callback(ipm, ipm_cb, NULL);
	if (device_is_ready(r2r)) {
		ipm_register_callback(r2r, r2r_cb, NULL);
		ipm_set_enabled(r2r, 1);
	}
	return ipm_set_enabled(ipm, 1);
}

static struct rpmsg_device *create_vdev(void)
{
	struct fw_rsc_vdev_vring *vr;
	struct virtio_device *vdev;

	vdev = rproc_virtio_create_vdev(VIRTIO_DEV_DEVICE, VDEV_ID, rsc_table_to_vdev(rsc_table),
					&rsc_io_data, NULL, mailbox_notify, NULL);
	if (!vdev) {
		return NULL;
	}
	rproc_virtio_wait_remote_ready(vdev);

	vr = rsc_table_get_vring0(rsc_table);
	if (rproc_virtio_init_vring(vdev, 0, vr->notifyid, (void *)vr->da, &rsc_io_data, vr->num,
				    vr->align)) {
		goto fail;
	}
	vr = rsc_table_get_vring1(rsc_table);
	if (rproc_virtio_init_vring(vdev, 1, vr->notifyid, (void *)vr->da, &rsc_io_data, vr->num,
				    vr->align)) {
		goto fail;
	}
	if (rpmsg_init_vdev(&rvdev, vdev, NULL, &shm_io_data, NULL)) {
		goto fail;
	}
	return rpmsg_virtio_get_rpmsg_device(&rvdev);

fail:
	rproc_virtio_remove_vdev(vdev);
	return NULL;
}

int main(void)
{
	struct rpmsg_device *rpdev;

	if (platform_init()) {
		return 0;
	}
	rpdev = create_vdev();
	if (!rpdev) {
		return 0;
	}
	rpmsg_create_ept(&echo_ept, rpdev, EPT_NAME, ECHO_ADDR, RPMSG_ADDR_ANY, echo_cb, NULL);
	shell_backend_rpmsg_init_transport(rpdev);
	rpmsg_create_ept(&calc_ept, rpdev, EPT_NAME, CALC_ADDR, RPMSG_ADDR_ANY, calc_cb, NULL);
	r51_audio_init(rpdev);   /* 0x460: 音の分業 */

	for (;;) {
		k_sem_take(&ipi_sem, K_FOREVER);
		rproc_virtio_notified(rvdev.vdev, VRING1_ID);
	}
	return 0;
}

/* ---- shell: r51 stats ---- */
static int cmd_stats(const struct shell *sh, size_t argc, char **argv)
{
	shell_print(sh, "R5_1: エコー %u 通 / 計算 %u 回 (平均 %u us) / 形式違い %u / R5_0 から直接 %u 回",
		    n_echo, n_calc, n_calc ? (uint32_t)(calc_sum_us / n_calc) : 0, n_bad, n_r2r);
	return 0;
}

SHELL_STATIC_SUBCMD_SET_CREATE(sub_r51, SHELL_CMD(stats, NULL, "R5_1 の統計", cmd_stats),
			       SHELL_SUBCMD_SET_END);
SHELL_CMD_REGISTER(r51, &sub_r51, "R5_1 (2 コア目)", NULL);
```

## src/r51_audio.c
```c
// -----------------------------------------------------------------------------
// r51_audio.c -- 音の分業 (R5_1 側): R5_1 が音を作ってリバーブを掛け、共有 DDR の輪バッファに書く
//
//   Linux (r5synth.py --r51)        R5_1 (ここ)                         R5_0 (audio_rpmsg.c 命令 13)
//     音符・波形・楽譜・リバーブ ─> 0x460 窓口
//                                   KICK を受けたら輪バッファが          1ms ごとに輪バッファ → PL の FIFO
//                                   TARGET 標本になるまで作って書く <── KICK (IPI、Linux を通さない)
//
//   音を作る部分は R5_0 の synth.c をそのまま使う (synth_next)。そのあとにリバーブ (残響) を掛ける。
//   リバーブは Freeverb の形 (並列の櫛形フィルタ 4 本 → 全域通過フィルタ 2 本) を整数で組んだもの。
//
//   命令 (Linux → R5_1)  u32 magic = 0x43445541 ("AUDC")  u32 cmd  u32 a  u32 b   (R5_0 の音声と同じ形)
//     5 状態  6 統計を消す  9 音符  10 波形  11 楽譜に足す  12 楽譜 (中身は R5_0 と同じ)
//     14 リバーブの量 a (0 = 無し、64 が既定、255 まで)
//     15 標本の速さ a Hz (I2S 48828 / HDMI 48000)
//   返事  u32 magic = 0x52445541 ("AUDR")  u32 status  u32 n_notes  u32 n_lat  u32 lat_max_us
//     u32 lat_avg_us  u32 active  u32 score_run  u32 gen_max_us  u32 gen_avg_us  u32 n_kick  u32 reverb
//     gen = KICK 1 回で作るのに掛かった時間。遅れ = 命令を受けてから、輪バッファの残り + FIFO の残量を経て鳴るまで
// -----------------------------------------------------------------------------
#include <zephyr/kernel.h>
#include <openamp/open_amp.h>
#include <string.h>

#include "synth.h"
#include "r2r_shm.h"

#define AUD_ADDR  0x460
#define MAGIC_CMD 0x43445541u
#define MAGIC_RES 0x52445541u
#define TARGET    256   /* 輪バッファにためておく標本 (約 5.2ms) */

struct aud_cmd {
	uint32_t magic, cmd, a, b;
} __packed;

struct aud_res {
	uint32_t magic, status, n_notes, n_lat, lat_max_us, lat_avg_us, active, score_run;
	uint32_t gen_max_us, gen_avg_us, n_kick, reverb;
} __packed;

static struct rpmsg_endpoint aud_ept;
static K_MUTEX_DEFINE(lock);
static K_SEM_DEFINE(kick_sem, 0, 1);
static uint32_t n_kick, gen_max_cyc;
static uint64_t gen_sum_cyc;

/* ---- リバーブ (Freeverb の形。遅延は 44.1kHz 用の値を 48.8kHz に合わせて 1.107 倍) ---- */
#define NCOMB 4
#define NAP   2
static const uint16_t comb_len[NCOMB] = {1724, 1790, 1651, 1574};
static const uint16_t ap_len[NAP] = {616, 249};
static int32_t comb_buf0[1724], comb_buf1[1790], comb_buf2[1651], comb_buf3[1574];
static int32_t ap_buf0[616], ap_buf1[249];
static int32_t *const comb_buf[NCOMB] = {comb_buf0, comb_buf1, comb_buf2, comb_buf3};
static int32_t *const ap_buf[NAP] = {ap_buf0, ap_buf1};
static uint16_t comb_i[NCOMB], ap_i[NAP];
static int32_t comb_lp[NCOMB];   /* 櫛形フィルタの中の 1 次ローパス (高音ほど早く減る = 部屋らしさ) */
static uint32_t reverb = 64;

static int32_t reverb_next(int32_t in)
{
	int32_t x = in >> 3;   /* 入れる量を絞る (櫛形は帰還で最大 6 倍ほどに増える) */
	int32_t wet = 0;

	for (int k = 0; k < NCOMB; k++) {
		int32_t y = comb_buf[k][comb_i[k]];

		comb_lp[k] += (y - comb_lp[k]) * 13 >> 4;            /* 減衰 (damp) 0.2 相当 */
		/* 帰還 0.93。最初は Freeverb に近い 0.84 にしたが、実測で響きが約 0.5 秒で消え、曲の中で聞こえなかった */
		comb_buf[k][comb_i[k]] = x + (comb_lp[k] * 30474 >> 15);
		if (++comb_i[k] == comb_len[k]) {
			comb_i[k] = 0;
		}
		wet += y;
	}
	for (int k = 0; k < NAP; k++) {
		int32_t b = ap_buf[k][ap_i[k]];

		ap_buf[k][ap_i[k]] = wet + (b >> 1);   /* 係数 0.5 */
		wet = b - wet;
		if (++ap_i[k] == ap_len[k]) {
			ap_i[k] = 0;
		}
	}
	return in + (wet * (int32_t)reverb >> 7);   /* 混ぜる量 (最初は wet/4 で小さすぎた) */
}

/* ---- 作るスレッド: KICK のたびに、輪バッファが TARGET になるまで作る ---- */
static void gen_thread(void *p1, void *p2, void *p3)
{
	for (;;) {
		k_sem_take(&kick_sem, K_FOREVER);
		k_mutex_lock(&lock, K_FOREVER);
		uint32_t c0 = k_cycle_get_32();
		uint32_t wr = R2R->wr;
		uint32_t have = wr - R2R->rd;

		if (have < TARGET) {
			synth_measure(have + R2R->fifo_level);   /* 今作る音の前に鳴る標本の数 */
			for (uint32_t k = have; k < TARGET; k++) {
				int32_t v = synth_next();
				/* 量 0 なら残響の計算ごと飛ばす (リバーブの重さを「作る時間」の差で測るため) */
				int32_t s = CLAMP(reverb ? reverb_next(v) : v, -32768, 32767);

				R2R->buf[wr++ & (R2R_RING - 1)] = ((uint32_t)(uint16_t)s << 16) | (uint16_t)s;
			}
			synth_block_end();
			R2R->wr = wr;
		}
		uint32_t c = k_cycle_get_32() - c0;

		n_kick++;
		gen_sum_cyc += c;
		gen_max_cyc = MAX(gen_max_cyc, c);
		k_mutex_unlock(&lock);
	}
}
K_THREAD_DEFINE(gen_tid, 1024, gen_thread, NULL, NULL, NULL, 2, 0, 0);

/* main.c の r2r_cb (割り込みの中) から: R5_0 が輪バッファを読んだ */
void r51_audio_kick(void)
{
	k_sem_give(&kick_sem);
}

static uint32_t cyc_us(uint64_t c)
{
	return (uint32_t)(c * 1000000U / sys_clock_hw_cycles_per_sec());
}

static int aud_cb(struct rpmsg_endpoint *e, void *data, size_t len, uint32_t src, void *priv)
{
	const struct aud_cmd *c = data;
	struct aud_res r = {.magic = MAGIC_RES};

	k_mutex_lock(&lock, K_FOREVER);
	if (len != sizeof(*c) || c->magic != MAGIC_CMD) {
		r.status = 2;
	} else {
		switch (c->cmd) {
		case 5:
			break;
		case 6:
			memset(&synth_st, 0, sizeof(synth_st));
			n_kick = 0;
			gen_sum_cyc = 0;
			gen_max_cyc = 0;
			break;
		case 9:
			synth_note(c->a & 0x7F, c->b & 0xFFFF, (c->b >> 16) & 0x7F);
			break;
		case 10:
			synth_wave(c->a);
			break;
		case 11:
			r.status = synth_score_add(c->a, c->b & 0x7F, c->b >> 16, (c->b >> 8) & 0x7F) ? 2 : 0;
			break;
		case 12:
			if (c->a) {
				synth_score_start();
			} else {
				synth_score_clear();
			}
			break;
		case 14:
			reverb = MIN(c->a, 255);
			break;
		case 15:  /* 標本の速さ a Hz (I2S 48828 / HDMI 48000)。R5_0 の命令 15 と同じ */
			if (c->a < 8000 || c->a > 96000) {
				r.status = 2;
			} else {
				synth_set_fs(c->a);
			}
			break;
		default:
			r.status = 2;
		}
	}
	r.n_notes = synth_st.n_notes;
	r.n_lat = synth_st.n_lat;
	r.lat_max_us = synth_st.lat_max_us;
	r.lat_avg_us = synth_st.n_lat ? (uint32_t)(synth_st.lat_sum_us / synth_st.n_lat) : 0;
	r.active = synth_active();
	r.score_run = synth_score_running();
	r.gen_max_us = cyc_us(gen_max_cyc);
	r.gen_avg_us = n_kick ? cyc_us(gen_sum_cyc / n_kick) : 0;
	r.n_kick = n_kick;
	r.reverb = reverb;
	k_mutex_unlock(&lock);
	rpmsg_send(e, &r, sizeof(r));
	return RPMSG_SUCCESS;
}

int r51_audio_init(struct rpmsg_device *rpdev)
{
	synth_init();
	R2R->wr = 0;
	R2R->rd = 0;
	R2R->fifo_level = 0;
	R2R->magic = R2R_MAGIC;   /* R5_0 はこれを見てから分業を始める */
	return rpmsg_create_ept(&aud_ept, rpdev, "rpmsg-raw", AUD_ADDR, RPMSG_ADDR_ANY, aud_cb, NULL);
}
```
