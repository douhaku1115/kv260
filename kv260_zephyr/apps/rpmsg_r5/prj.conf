## CMakeLists.txt
```
cmake_minimum_required(VERSION 3.20.0)
find_package(Zephyr REQUIRED HINTS $ENV{ZEPHYR_BASE})
project(rpmsg_r5)

# OpenAMP / libmetal と、Zephyr の resource_table.h・addr_translation.h の置き場所
target_include_directories(app PRIVATE ${LIBMETAL_INCLUDE_DIR} ${OPENAMP_INCLUDE_DIR} ${PLATFORM_DIR})
target_sources(app PRIVATE src/main.c src/cnn_rpmsg.c src/audio_rpmsg.c src/synth.c src/r2r.c)

# リソーステーブルを BTCM に置く (rsc_table.ld の説明を参照)
zephyr_linker_sources(RAM_SECTIONS rsc_table.ld)

# R5_0 と R5_1 の取り決め (apps/common/r2r_shm.h)
target_include_directories(app PRIVATE ${CMAKE_CURRENT_SOURCE_DIR}/../common)
```

## prj.conf
```kconfig
# Linux の remoteproc から起動され、RPMsg で Linux と話す (段2)
CONFIG_PRINTK=y
CONFIG_IPM=y
CONFIG_OPENAMP=y
CONFIG_OPENAMP_RSC_TABLE=y
CONFIG_OPENAMP_RSC_TABLE_NUM_RPMSG_BUFF=8
CONFIG_OPENAMP_MASTER=n
CONFIG_HEAP_MEM_POOL_SIZE=1024
CONFIG_MAIN_STACK_SIZE=1024

# shell を RPMsg で Linux から使う。名前を rpmsg-raw にして Linux の rpmsg_char (/dev/rpmsgN) で受ける
# (既定の rpmsg-tty はカーネルに rpmsg_tty が無いので使えない)。番号 0x440 でエコー (0x400) と見分ける。
# ★R5 側の番号は 0x400〜0x47F (OpenAMP の RPMSG_ADDR_BMP_SIZE=128) だけ。0x500 にしたら作成失敗した
CONFIG_SHELL=y
CONFIG_SHELL_BACKEND_RPMSG=y
CONFIG_SHELL_RPMSG_SERVICE_NAME="rpmsg-raw"
CONFIG_SHELL_RPMSG_SRC_ADDR=0x440
# UART の shell は外す (UART1 は Linux のコンソールと共用。Linux への入力を Zephyr も読んでしまう)
CONFIG_SHELL_BACKEND_SERIAL=n
CONFIG_KERNEL_SHELL=y
CONFIG_THREAD_MONITOR=y
CONFIG_THREAD_NAME=y

# コードを ATCM、変数を BTCM に分ける (rpmsg.overlay の zephyr,flash / zephyr,sram)
CONFIG_XIP=y
# 初期値つき変数を BTCM に直接置くリンカスクリプト (linker.ld の説明を参照)
CONFIG_HAVE_CUSTOM_LINKER_SCRIPT=y
CONFIG_CUSTOM_LINKER_SCRIPT="linker.ld"

# R5_1 と割り込みコントローラ (GIC) を共用する。行き先を最初は空にし、各コアが自分の割り込みだけ
# 自分宛てに足す。無いと R5_0 が全部の割り込みを自分宛てにし、R5_1 のタイマー割り込みが R5_0 にも届いて止まる
CONFIG_GIC_SAFE_CONFIG=y
```

## src/main.c
```c
// -----------------------------------------------------------------------------
// main.c -- Linux (A53) と RPMsg で話す R5 側。Linux の remoteproc から起動される (段2)
//
//   Linux                                   R5 (この Zephyr)
//     remoteproc が elf を TCM に書き、
//     リソーステーブルに vring の番地を書いて R5 を起動
//                                           vring を作り「rpmsg-raw」という名前を名乗る
//     rpmsg_char が /dev/rpmsg0 を作る  <── (名前の通知)
//     /dev/rpmsg0 に書く   ──────────────>  受信コールバック: "R5: " を付けて送り返す
//     /dev/rpmsg0 から読む <──────────────
//     /dev/rpmsg1 (番号 0x440) ── shell のコマンドと応答 (linux/r5_shell.sh でつなぐ)
//     番号 0x410 ── PL の CNN の推論依頼 (cnn_rpmsg.c、linux/cnn_rpmsg.py)
//
//   起動の流れは Zephyr の samples/subsys/ipc/openamp_rsc_table の main_remote.c と同じ。
//   shell と rpmsg-tty を外して小さくした (公式のままだと 83KB で TCM 64KB に入らない)。
//   共有メモリの番地は ../../rpmsg.overlay と linux/r5_rpmsg.dtso で合わせてある。
// -----------------------------------------------------------------------------
#include <zephyr/kernel.h>
#include <zephyr/device.h>
#include <zephyr/drivers/ipm.h>
#include <zephyr/sys/printk.h>
#include <zephyr/shell/shell_rpmsg.h>
#include <string.h>

#include <openamp/open_amp.h>
#include <metal/sys.h>
#include <metal/io.h>
#include <resource_table.h>
#include <addr_translation.h>

#define SHM_NODE       DT_CHOSEN(zephyr_ipc_shm)
#define SHM_START_ADDR DT_REG_ADDR(SHM_NODE)
#define SHM_SIZE       DT_REG_SIZE(SHM_NODE)

#define EPT_NAME "rpmsg-raw"   /* Linux の rpmsg_char がこの名前で /dev/rpmsgN を作る */

int cnn_rpmsg_init(struct rpmsg_device *rpdev);   /* cnn_rpmsg.c */
int audio_rpmsg_init(struct rpmsg_device *rpdev); /* audio_rpmsg.c */

static const struct device *const ipm = DEVICE_DT_GET(DT_CHOSEN(zephyr_ipc));

static metal_phys_addr_t shm_physmap = SHM_START_ADDR;
static metal_phys_addr_t rsc_tab_physmap;
static struct metal_io_region shm_io_data;   /* vdev0buffer (メッセージ本体) */
static struct metal_io_region rsc_io_data;   /* リソーステーブル */
static struct rpmsg_virtio_device rvdev;
static void *rsc_table;

static struct rpmsg_endpoint ept;
static uint32_t rx_count;

static K_SEM_DEFINE(ipi_sem, 0, 1);

/* ---- IPI の受信 (割り込みの中): 起こすだけ。中身は vring を見て処理する ---- */
/* r2r.c から: R5_1 の合図を処理した時、同時に来た Linux の合図が消されていても取りこぼさないよう
 * 受信リングを見に行かせる (理由は apps/rpmsg_r5_1/src/main.c の r2r_cb)
 */
void rpmsg_poke(void)
{
	k_sem_give(&ipi_sem);
}

static void ipm_cb(const struct device *dev, void *ctx, uint32_t id, volatile void *data)
{
	k_sem_give(&ipi_sem);
}

/* ---- OpenAMP から呼ばれる「相手に知らせて」: IPI を 1 回打つ ---- */
static int mailbox_notify(void *priv, uint32_t id)
{
	ipm_send(ipm, 0, id, &id, sizeof(id));
	return 0;
}

/* ---- rpmsg-raw の受信: "R5: " を付けて送り返す (管理スレッドの中で呼ばれる) ---- */
static int ept_cb(struct rpmsg_endpoint *e, void *data, size_t len, uint32_t src, void *priv)
{
	static char tx[RPMSG_BUFFER_SIZE];   /* 1 通の最大 (512 - ヘッダ) に収める */
	size_t n = MIN(len, sizeof(tx) - 4);

	memcpy(tx, "R5: ", 4);
	memcpy(tx + 4, data, n);
	rx_count++;
	/* 毎回表示すると UART (115200bps、1 行約 30 文字 = 約 2.6ms) が往復時間の大半になる。
	 * 最初の 3 通と 1000 通ごとだけ表示する
	 */
	if (rx_count <= 3 || rx_count % 1000 == 0) {
		printk("[R5] #%u 受信 %u バイト\n", rx_count, (unsigned int)len);
	}
	rpmsg_send(e, tx, n + 4);
	return RPMSG_SUCCESS;
}

static int platform_init(void)
{
	struct metal_init_params mp = METAL_INIT_DEFAULTS;
	int rsc_size;

	if (metal_init(&mp)) {
		return -1;
	}
	metal_io_init(&shm_io_data, (void *)SHM_START_ADDR, &shm_physmap, SHM_SIZE, -1, 0,
		      addr_translation_get_ops(shm_physmap));

	rsc_table_get(&rsc_table, &rsc_size);
	rsc_tab_physmap = (uintptr_t)rsc_table;
	metal_io_init(&rsc_io_data, rsc_table, &rsc_tab_physmap, rsc_size, -1, 0, NULL);

	if (!device_is_ready(ipm)) {
		return -2;
	}
	ipm_register_callback(ipm, ipm_cb, NULL);
	return ipm_set_enabled(ipm, 1);
}

static struct rpmsg_device *create_vdev(void)
{
	struct fw_rsc_vdev_vring *vr;
	struct virtio_device *vdev;

	vdev = rproc_virtio_create_vdev(VIRTIO_DEV_DEVICE, VDEV_ID, rsc_table_to_vdev(rsc_table),
					&rsc_io_data, NULL, mailbox_notify, NULL);
	if (!vdev) {
		return NULL;
	}

	/* Linux がリソーステーブルに vring の番地を書き終えるのを待つ */
	rproc_virtio_wait_remote_ready(vdev);

	vr = rsc_table_get_vring0(rsc_table);
	printk("[R5] vring0 da=0x%08x num=%u\n", (unsigned int)vr->da, (unsigned int)vr->num);
	if (rproc_virtio_init_vring(vdev, 0, vr->notifyid, (void *)vr->da, &rsc_io_data, vr->num,
				    vr->align)) {
		goto fail;
	}
	vr = rsc_table_get_vring1(rsc_table);
	printk("[R5] vring1 da=0x%08x num=%u\n", (unsigned int)vr->da, (unsigned int)vr->num);
	if (rproc_virtio_init_vring(vdev, 1, vr->notifyid, (void *)vr->da, &rsc_io_data, vr->num,
				    vr->align)) {
		goto fail;
	}
	if (rpmsg_init_vdev(&rvdev, vdev, NULL, &shm_io_data, NULL)) {
		goto fail;
	}
	return rpmsg_virtio_get_rpmsg_device(&rvdev);

fail:
	rproc_virtio_remove_vdev(vdev);
	return NULL;
}

int main(void)
{
	struct rpmsg_device *rpdev;
	int ret;

	printk("[R5] RPMsg 段2: 起動\n");

	ret = platform_init();
	if (ret) {
		printk("[R5] 初期化失敗 %d\n", ret);
		return 0;
	}
	printk("[R5] リソーステーブル @%p\n", rsc_table);
	rpdev = create_vdev();
	if (!rpdev) {
		printk("[R5] vdev 作成失敗\n");
		return 0;
	}
	ret = rpmsg_create_ept(&ept, rpdev, EPT_NAME, RPMSG_ADDR_ANY, RPMSG_ADDR_ANY, ept_cb,
			       NULL);
	printk("[R5] 窓口 \"%s\" %s\n", EPT_NAME, ret ? "作成失敗" : "作成 (Linux に通知済)");

	/* shell も RPMsg に載せる (名前 rpmsg-raw、番号 0x440。prj.conf)。
	 * Linux 側は linux/r5_shell.sh で番号 0x440 の /dev/rpmsgN を探してつなぐ
	 */
	ret = shell_backend_rpmsg_init_transport(rpdev);
	printk("[R5] shell (0x%x) %s\n", CONFIG_SHELL_RPMSG_SRC_ADDR, ret ? "失敗" : "開始");

	/* PL の CNN の窓口 (番号 0x410。cnn_rpmsg.c)。PL には依頼が来るまで触らない */
	ret = cnn_rpmsg_init(rpdev);
	printk("[R5] CNN 窓口 (0x410) %s\n", ret ? "作成失敗" : "作成");

	/* PL の音声 FIFO の窓口 (番号 0x420。audio_rpmsg.c)。再生の命令が来るまで PL には触らない */
	ret = audio_rpmsg_init(rpdev);
	printk("[R5] 音声 窓口 (0x420) %s\n", ret ? "作成失敗" : "作成");

	/* IPI が来るたびに vring を見る。受信コールバックはこの中から呼ばれる */
	for (;;) {
		k_sem_take(&ipi_sem, K_FOREVER);
		rproc_virtio_notified(rvdev.vdev, VRING1_ID);
	}
	return 0;
}
```

## src/audio_rpmsg.c
```c
// -----------------------------------------------------------------------------
// audio_rpmsg.c -- R5 が音を途切れさせずに PL へ流す担当になる (Linux は指示を出すだけ)
//
//   Linux (linux/r5play.py)              R5 (ここ)                          PL (kv260_i2s2 の stream 設計)
//     音源を DDR 0x60000000 に置く
//     「再生 番地 長さ」を RPMsg で送る ─> 5ms ごとに FIFO の残量を見て ───>  0x00 DATA → FIFO(8192段)
//                                         空いた分を DDR から書き足す           → 音量・エコー → I2S → DAC
//     音量・エコー・停止・状態        <─> 返事 (再生位置・最小残量・空になった回数)
//
//   窓口: 名前 rpmsg-raw、番号 0x420 (Linux では virtio0.rpmsg-raw.-1.1056 の /dev/rpmsgN)
//
//   Linux の play.c (段5) は自分で FIFO を満たしていたので、Linux が忙しいと音が切れるおそれがあった。
//   ここでは R5 の優先度の高いスレッドが 5ms 周期で満たすので、Linux の負荷と関係なく流れ続ける。
//   本当にそうかは「最小残量」と「空になった回数」で測る。
//
//   命令 (Linux → R5、リトルエンディアン)  u32 magic = 0x43445541 ("AUDC")  u32 cmd  u32 a  u32 b
//     cmd 1 = 再生  a = DDR の物理番地  b = バイト数 (4 の倍数。1 語 = 左右 1 組。並びは dmaplay と同じ)
//     cmd 2 = 停止 (FIFO に残った分を鳴らし切ってから止める)
//     cmd 3 = 音量 a (64 で等倍)   cmd 4 = エコー a (0 で無し)
//     cmd 5 = 状態を返すだけ       cmd 6 = 統計を消す
//     cmd 7 = 書き足しの上限 a 段 (1〜8192。既定 8192)。FIFO を浅く使い、遅延の小さい再生を真似る試験用
//     cmd 8〜12 = シンセ (R5 が音を作る。synth.c)。8 開始/停止 9 音符 10 波形 11 楽譜に足す 12 楽譜の演奏/消去
//     cmd 13 = 分業 a=1 開始 / a=0 停止。R5_1 が作って共有 DDR の輪バッファに書いた音を、1ms ごとに
//              FIFO へ移し、R5_1 に「足して」と IPI で知らせる (r2r.c、apps/common/r2r_shm.h)
//     cmd 15 = 標本の速さ a Hz。PL の出口が I2S なら 48828、HDMI (stream_hdmi.bit の OUT_SEL=1) なら 48000
//       中身は do_cmd() の各 case のコメント。返事の後ろにシンセの統計が付く (struct aud_res)
//   返事 (どの命令にも 1 通)  u32 magic = 0x52445541 ("AUDR")  u32 status (0=正常 1=PLが音声設計でない 2=形式違い)
//     u32 playing  u32 pos (送ったバイト数)  u32 len  u32 level (今の残量)  u32 min_level  u32 n_empty
//     u32 n_tick  u32 fill_max_us (1 回の書き足しに掛かった最長時間)
//
//   ★PL は空のこともあるので、再生の命令が来るまで PL には触らない (0x00 が 0xDEADBEEF かを先に確かめる)
// -----------------------------------------------------------------------------
#include <zephyr/kernel.h>
#include <zephyr/shell/shell.h>
#include <zephyr/sys/sys_io.h>

#include <openamp/open_amp.h>
#include <string.h>

#include "synth.h"
#include "r2r_shm.h"

void r2r_kick(uint32_t rd);   /* r2r.c */

#define AUD_EPT_ADDR 0x420

#define AUD_BASE   0xA0000000UL   /* rpmsg.overlay の pl_axi で入出力領域として MPU 登録済み */
#define REG_DATA   (AUD_BASE + 0x00)   /* W: 1 組書く / R: 0xDEADBEEF */
#define REG_STATUS (AUD_BASE + 0x10)   /* bit0 満杯 bit1 空 bit29..16 残量 */
#define REG_CTRL   (AUD_BASE + 0x20)   /* bit0 再生 */
#define REG_GAIN   (AUD_BASE + 0x30)
#define REG_ECHO   (AUD_BASE + 0x40)
#define AUD_ID     0xDEADBEEFu
#define FIFO_DEPTH 8192

#define DDR_LO 0x60000000UL   /* rpmsg.overlay の pl_ddr (Linux 管理外の 512MB) */
#define DDR_HI 0x80000000UL

#define MAGIC_CMD 0x43445541u   /* "AUDC" */
#define MAGIC_RES 0x52445541u   /* "AUDR" */

#define PERIOD_MS 5
#define SYNTH_PERIOD_MS 1   /* シンセは FIFO を浅く使う (既定の上限は Linux 側で 256 段) ので 1ms ごと */

struct aud_cmd {
	uint32_t magic, cmd, a, b;
} __packed;

struct aud_res {
	uint32_t magic, status, playing, pos, len, level, min_level, n_empty, n_tick, fill_max_us;
	/* シンセ (synth.c) */
	uint32_t synth_on, n_notes, n_lat, lat_max_us, lat_avg_us, active, score_run;
	/* 分業 (cmd 13): 輪バッファが FIFO の空きを埋めきれなかった回数 */
	uint32_t ring_on, n_ring_short;
} __packed;

static struct rpmsg_endpoint aud_ept;

/* 再生の状態。受信コールバック (管理スレッド) と書き足しスレッドの両方から触るので鍵を掛ける */
static K_MUTEX_DEFINE(lock);   /* 割り込みは止めない (初回の 8192 語書きが長いので) */
static uint32_t src_addr, src_len, src_pos;   /* DDR の番地・長さ・送り済み (バイト) */
static bool playing;    /* 書き足し中 */
static bool draining;   /* 停止命令の後、FIFO を鳴らし切るのを待っている */
static bool pl_used;    /* 一度でも PL を確かめた (それまで PL に触らない) */
static uint32_t limit = FIFO_DEPTH;   /* 残量をここまでしか満たさない (cmd 7) */
static bool synth_on;   /* シンセで音を作っている (synth.c) */
static bool primed;     /* シンセ/分業で 1 回満たした (それまでは空でも数えない) */
static bool ring_on;    /* 分業: R5_1 が作った音を輪バッファから流している */
static uint32_t n_ring_short;

/* 統計 */
static uint32_t level_now, min_level = FIFO_DEPTH, n_empty, n_tick;
static uint32_t fill_max_cyc;

static K_SEM_DEFINE(tick_sem, 0, 1);

static void tick_fn(struct k_timer *t)
{
	k_sem_give(&tick_sem);
}
static K_TIMER_DEFINE(tick_timer, tick_fn, NULL);

static void reset_stats(void)
{
	min_level = FIFO_DEPTH;
	n_empty = 0;
	n_tick = 0;
	fill_max_cyc = 0;
}

static uint32_t cyc_to_us(uint32_t c)
{
	return (uint32_t)((uint64_t)c * 1000000U / sys_clock_hw_cycles_per_sec());
}

/* FIFO の空き分だけ DDR から書き足す。戻り値は書いた語数 */
static uint32_t fill(void)
{
	uint32_t st = sys_read32(REG_STATUS);
	uint32_t level = (st >> 16) & 0x3FFF;
	uint32_t room = level < limit ? limit - level : 0;
	uint32_t left = (src_len - src_pos) / 4;
	uint32_t n = MIN(room, left);
	uint32_t a = src_addr + src_pos;

	for (uint32_t i = 0; i < n; i++) {
		sys_write32(sys_read32(a + i * 4), REG_DATA);
	}
	src_pos += n * 4;
	return n;
}

/* ---- 書き足しスレッド (優先度 2。CNN は 5、shell はさらに下) ---- */
static void audio_thread(void *p1, void *p2, void *p3)
{
	for (;;) {
		k_sem_take(&tick_sem, K_FOREVER);
		k_mutex_lock(&lock, K_FOREVER);

		if (playing) {
			uint32_t st = sys_read32(REG_STATUS);

			level_now = (st >> 16) & 0x3FFF;
			n_tick++;
			/* 曲の途中で残量を見る。空なら音が途切れている */
			min_level = MIN(min_level, level_now);
			if (st & 0x2) {
				n_empty++;
			}
			uint32_t c0 = k_cycle_get_32();

			fill();
			fill_max_cyc = MAX(fill_max_cyc, k_cycle_get_32() - c0);
			if (src_pos >= src_len) {   /* 全部送った。あとは鳴らし切る */
				playing = false;
				draining = true;
			}
		} else if (synth_on) {
			/* シンセ: 1ms ごとに、上限まで足りない分の標本を作って書く */
			uint32_t st = sys_read32(REG_STATUS);

			level_now = (st >> 16) & 0x3FFF;
			n_tick++;
			if (primed) {   /* 出だしは空から始まるので、1 回満たしてから数える */
				min_level = MIN(min_level, level_now);
				if (st & 0x2) {
					n_empty++;
				}
			}
			uint32_t c0 = k_cycle_get_32();

			synth_render(level_now < limit ? limit - level_now : 0, level_now);
			fill_max_cyc = MAX(fill_max_cyc, k_cycle_get_32() - c0);
			primed = true;
		} else if (ring_on) {
			/* 分業: 輪バッファにある分を、FIFO の上限まで移す。そのあと R5_1 に「足して」 */
			uint32_t st = sys_read32(REG_STATUS);

			level_now = (st >> 16) & 0x3FFF;
			n_tick++;
			if (primed) {
				min_level = MIN(min_level, level_now);
				if (st & 0x2) {
					n_empty++;
				}
			}
			uint32_t c0 = k_cycle_get_32();
			uint32_t room = level_now < limit ? limit - level_now : 0;
			uint32_t rd = R2R->rd;
			uint32_t avail = R2R->wr - rd;
			uint32_t n = MIN(room, avail);

			if (primed && avail < room) {
				n_ring_short++;   /* R5_1 が間に合わなかった */
			}
			for (uint32_t i = 0; i < n; i++) {
				sys_write32(R2R->buf[(rd + i) & (R2R_RING - 1)], REG_DATA);
			}
			rd += n;
			R2R->rd = rd;
			R2R->fifo_level = level_now + n;
			r2r_kick(rd);
			fill_max_cyc = MAX(fill_max_cyc, k_cycle_get_32() - c0);
			primed = true;
		} else if (draining) {
			uint32_t st = sys_read32(REG_STATUS);

			level_now = (st >> 16) & 0x3FFF;
			if (st & 0x2) {
				sys_write32(0, REG_CTRL);
				draining = false;
				k_timer_stop(&tick_timer);
			}
		}
		k_mutex_unlock(&lock);
	}
}
K_THREAD_DEFINE(audio_tid, 1024, audio_thread, NULL, NULL, NULL, 2, 0, 0);

static int do_cmd(const struct aud_cmd *c)
{
	/* PL に触る命令 (1〜4 と 8) の前に、PL が音声設計かを確かめる。
	 * 再生とシンセの開始 (1, 8) は毎回、ほかは最初の 1 回だけ。5〜7, 9〜12 は PL に触らない
	 */
	bool start = c->cmd == 1 || ((c->cmd == 8 || c->cmd == 13) && c->a);

	if (start || (!pl_used && c->cmd >= 2 && c->cmd <= 4)) {
		if (sys_read32(REG_DATA) != AUD_ID) {
			return 1;
		}
		pl_used = true;
	}
	switch (c->cmd) {
	case 1:
		if (c->a < DDR_LO || c->b == 0 || (c->a | c->b) & 3 || c->b > DDR_HI - c->a) {
			return 2;
		}
		if (playing || draining || synth_on || ring_on) {
			return 2;   /* 再生中 (先に止める) */
		}
		src_addr = c->a;
		src_len = c->b;
		src_pos = 0;
		reset_stats();
		/* FIFO は空のはず (前回は鳴らし切ってから止めている)。先に満たしてから鳴らし始める */
		sys_write32(0, REG_CTRL);
		fill();
		sys_write32(1, REG_CTRL);
		playing = src_pos < src_len;
		draining = !playing;
		k_timer_start(&tick_timer, K_MSEC(PERIOD_MS), K_MSEC(PERIOD_MS));
		return 0;
	case 2:
		if (playing) {
			playing = false;
			draining = true;
		}
		return 0;
	case 3:
		sys_write32(c->a & 0xFF, REG_GAIN);
		return 0;
	case 4:
		sys_write32(c->a & 0xFF, REG_ECHO);
		return 0;
	case 5:
		return 0;
	case 7:
		if (c->a == 0 || c->a > FIFO_DEPTH) {
			return 2;
		}
		limit = c->a;
		return 0;
	case 6:
		reset_stats();
		return 0;
	case 13:  /* 分業 a=1 開始 / a=0 停止 */
		if (c->a) {
			if (playing || draining || synth_on || ring_on) {
				return 2;
			}
			if (R2R->magic != R2R_MAGIC) {
				return 3;   /* R5_1 が輪バッファを用意していない (R5_1 は動いている?) */
			}
			reset_stats();
			n_ring_short = 0;
			primed = false;
			R2R->rd = R2R->wr;   /* 古い分は捨てる */
			R2R->fifo_level = 0;
			ring_on = true;
			sys_write32(1, REG_CTRL);
			r2r_kick(R2R->rd);   /* 先に作らせる (最初の 1ms で輪バッファがたまる) */
			k_timer_start(&tick_timer, K_MSEC(SYNTH_PERIOD_MS), K_MSEC(SYNTH_PERIOD_MS));
		} else if (ring_on) {
			ring_on = false;
			draining = true;
		}
		return 0;
	case 8:   /* シンセ a=1 開始 / a=0 停止 */
		if (c->a) {
			if (playing || draining || synth_on || ring_on) {
				return 2;
			}
			reset_stats();
			memset(&synth_st, 0, sizeof(synth_st));
			primed = false;
			synth_on = true;
			sys_write32(1, REG_CTRL);
			k_timer_start(&tick_timer, K_MSEC(SYNTH_PERIOD_MS), K_MSEC(SYNTH_PERIOD_MS));
		} else if (synth_on) {
			synth_on = false;
			draining = true;   /* 残りを鳴らし切ってから止める (再生と同じ) */
		}
		return 0;
	case 9:   /* 音符 a = 音の高さ (MIDI 番号、60 = ド)  b = 長さ ms | 強さ (0〜127) << 16 */
		if (!synth_on) {
			return 2;
		}
		synth_note(c->a & 0x7F, c->b & 0xFFFF, (c->b >> 16) & 0x7F);
		return 0;
	case 10:  /* 波形 a = 0 正弦 1 矩形 2 のこぎり 3 三角 */
		synth_wave(c->a);
		return 0;
	case 11:  /* 楽譜に 1 音足す a = 時刻 ms  b = 高さ | 強さ << 8 | 長さ ms << 16 */
		return synth_score_add(c->a, c->b & 0x7F, c->b >> 16, (c->b >> 8) & 0x7F) ? 2 : 0;
	case 12:  /* 楽譜 a=1 演奏開始 / a=0 消す */
		if (c->a) {
			if (!synth_on) {
				return 2;
			}
			synth_score_start();
		} else {
			synth_score_clear();
		}
		return 0;
	case 15:  /* 標本の速さ a Hz (I2S 48828 / HDMI 48000)。シンセの高さ・長さの計算に使う */
		if (c->a < 8000 || c->a > 96000) {
			return 2;
		}
		synth_set_fs(c->a);
		return 0;
	default:
		return 2;
	}
}

static int aud_cb(struct rpmsg_endpoint *e, void *data, size_t len, uint32_t src, void *priv)
{
	const struct aud_cmd *c = data;
	struct aud_res r = {.magic = MAGIC_RES};
	k_mutex_lock(&lock, K_FOREVER);

	if (len != sizeof(*c) || c->magic != MAGIC_CMD) {
		r.status = 2;
	} else {
		r.status = do_cmd(c);
	}
	r.playing = playing || draining;
	r.pos = src_pos;
	r.len = src_len;
	r.level = level_now;
	r.min_level = min_level;
	r.n_empty = n_empty;
	r.n_tick = n_tick;
	r.fill_max_us = cyc_to_us(fill_max_cyc);
	r.synth_on = synth_on;
	r.n_notes = synth_st.n_notes;
	r.n_lat = synth_st.n_lat;
	r.lat_max_us = synth_st.lat_max_us;
	r.lat_avg_us = synth_st.n_lat ? (uint32_t)(synth_st.lat_sum_us / synth_st.n_lat) : 0;
	r.active = synth_active();
	r.score_run = synth_score_running();
	r.ring_on = ring_on;
	r.n_ring_short = n_ring_short;
	k_mutex_unlock(&lock);
	rpmsg_send(e, &r, sizeof(r));
	return RPMSG_SUCCESS;
}

int audio_rpmsg_init(struct rpmsg_device *rpdev)
{
	synth_init();
	return rpmsg_create_ept(&aud_ept, rpdev, "rpmsg-raw", AUD_EPT_ADDR, RPMSG_ADDR_ANY, aud_cb,
				NULL);
}

/* ---- shell: audio stats ---- */
static int cmd_stats(const struct shell *sh, size_t argc, char **argv)
{
	shell_print(sh, "再生 %s / 送った %u / %u バイト", playing ? "中" : (draining ? "鳴らし切り中" : "停止"),
		    src_pos, src_len);
	shell_print(sh, "残量 今 %u 最小 %u (8192 段) / 空になった回数 %u / 見回り %u 回", level_now,
		    min_level, n_empty, n_tick);
	shell_print(sh, "1 回の書き足し 最長 %u us", cyc_to_us(fill_max_cyc));
	return 0;
}

SHELL_STATIC_SUBCMD_SET_CREATE(sub_audio,
	SHELL_CMD(stats, NULL, "音声の書き足しの統計", cmd_stats),
	SHELL_SUBCMD_SET_END);
SHELL_CMD_REGISTER(audio, &sub_audio, "PL の音声 FIFO (RPMsg で Linux から指示)", NULL);
```

## src/cnn_rpmsg.c
```c
// -----------------------------------------------------------------------------
// cnn_rpmsg.c -- Linux から RPMsg で頼まれた画像を PL の CNN で推論して返す (段2の続き)
//
//   Linux (linux/cnn_rpmsg.py)             R5 (ここ)                         PL (CNN, 0xA0000000)
//     画像 784 バイトを 2 通に分けて送る ─> 受信コールバック: 1 枚分ためる
//                                          推論スレッド: 画素を PL へ ──────>  推論 (約 2ms)
//     答え・スコア・推論時間を受け取る  <─ 結果を 1 通で返す
//
//   窓口: 名前 rpmsg-raw、番号 0x410 (Linux では virtio0.rpmsg-raw.-1.1040 の /dev/rpmsgN)
//   RPMsg の 1 通は最大 496 バイトなので、画像は分けて送る。
//
//   依頼 (Linux → R5、リトルエンディアン)
//     u32 magic = 0x494E4E43 ("CNNI")  u32 seq  u16 off  u16 len  u8 画素[len]
//     off は画像の中の位置 (0 から)。off + len = 784 の通が届いたら推論する
//   返事 (R5 → Linux)
//     u32 magic = 0x524E4E43 ("CNNR")  u32 seq  u32 status (0=正常 1=PLがCNNでない 2=形式違い)
//     u32 digit  u32 run_us (PL の推論時間)  i32 score[10]
//
//   ★R5 は電源投入時に自動で起動するが、PL はまだ空。空の PL の番地を読むと止まるおそれがあるので、
//    依頼が来るまで PL には触らない。PL の書き込み (fpgautil) とクロック (devmem) は Linux 側で先にやる。
// -----------------------------------------------------------------------------
#include <zephyr/kernel.h>
#include <zephyr/shell/shell.h>
#include <zephyr/sys/printk.h>
#include <zephyr/sys/sys_io.h>
#include <string.h>

#include <openamp/open_amp.h>

#define CNN_EPT_ADDR 0x410   /* R5 側で使える番号は 0x400〜0x47F */

#define CNN_BASE   0xA0000000UL   /* pl_axi.overlay で MPU に入出力領域として登録 */
#define REG_ID     (CNN_BASE + 0x00)
#define REG_STATUS (CNN_BASE + 0x10)
#define REG_CTRL   (CNN_BASE + 0x20)
#define REG_IMG    (CNN_BASE + 0x30)
#define REG_DIGIT  (CNN_BASE + 0x40)
#define REG_SEL    (CNN_BASE + 0x50)
#define REG_SCORE  (CNN_BASE + 0x60)
#define CNN_ID     0xC4400001u

#define XLEN 784
#define NOUT 10

#define MAGIC_REQ 0x494E4E43u   /* "CNNI" */
#define MAGIC_RES 0x524E4E43u   /* "CNNR" */

struct cnn_req {
	uint32_t magic;
	uint32_t seq;
	uint16_t off;
	uint16_t len;
	uint8_t px[];
} __packed;

struct cnn_res {
	uint32_t magic;
	uint32_t seq;
	uint32_t status;
	uint32_t digit;
	uint32_t run_us;
	int32_t score[NOUT];
} __packed;

static struct rpmsg_endpoint cnn_ept;
static uint8_t img[XLEN];         /* 受信中の 1 枚 */
static uint32_t img_fill;         /* 届いた画素の数 */
static uint32_t img_seq;
static K_SEM_DEFINE(img_ready, 0, 1);
static volatile bool busy;        /* 推論中 (この間に次の画像が来たら形式違いとして数える) */

/* 統計 (shell の cnn stats) */
static uint32_t n_done, n_bad_msg, n_not_cnn;
static uint64_t run_sum_us;
static uint32_t run_min_us = UINT32_MAX, run_max_us;

/* 1 枚の処理の内訳 (サイクルの合計)。往復 4.4ms のうち PL の推論 2.1ms 以外がどこかを調べる */
enum { T_WAKE, T_PX, T_INFER, T_READ, T_SEND, T_N };
static const char *const t_name[T_N] = {"起床", "画素", "推論", "読出", "送信"};
static uint64_t t_sum[T_N];
static uint32_t c_rx;   /* 最後の断片を受けた時刻 */

/* ---- 受信 (管理スレッドの中): 画素をためるだけ。そろったら推論スレッドを起こす ---- */
static int cnn_cb(struct rpmsg_endpoint *e, void *data, size_t len, uint32_t src, void *priv)
{
	const struct cnn_req *q = data;

	if (len < sizeof(*q) || q->magic != MAGIC_REQ || len != sizeof(*q) + q->len ||
	    q->off + q->len > XLEN || busy) {
		n_bad_msg++;
		return RPMSG_SUCCESS;
	}
	if (q->off == 0) {
		img_fill = 0;
		img_seq = q->seq;
	}
	if (q->seq != img_seq || q->off != img_fill) {   /* 順番が飛んだ */
		n_bad_msg++;
		img_fill = 0;
		return RPMSG_SUCCESS;
	}
	memcpy(&img[q->off], q->px, q->len);
	img_fill += q->len;
	if (img_fill == XLEN) {
		c_rx = k_cycle_get_32();
		busy = true;
		k_sem_give(&img_ready);
	}
	return RPMSG_SUCCESS;
}

/* ---- 推論スレッド: 画素を PL に書いて推論し、結果を返す ---- */
static void cnn_thread(void *a, void *b, void *c)
{
	struct cnn_res r;

	for (;;) {
		k_sem_take(&img_ready, K_FOREVER);
		uint32_t c[T_N + 1];

		c[0] = c_rx;
		c[1] = k_cycle_get_32();   /* 起床 */
		memset(&r, 0, sizeof(r));
		r.magic = MAGIC_RES;
		r.seq = img_seq;

		if (sys_read32(REG_ID) != CNN_ID) {
			r.status = 1;
			n_not_cnn++;
		} else {
			sys_write32(0x6, REG_CTRL);   /* 画素ポインタを戻し、終了フラグを消す */
			for (int i = 0; i < XLEN; i++) {
				sys_write32(img[i], REG_IMG);
			}
			uint32_t c0 = k_cycle_get_32();

			c[2] = c0;   /* 画素を書き終えた */

			/* 終了待ちは空回りしない (Linux は返事を受けるとすぐ次を頼むので、空回りすると
			 * shell など優先の低いスレッドが動けなくなる。段3で確認)。1 ティック (1ms) ずつ休む
			 */
			sys_write32(0x1, REG_CTRL);
			while (!(sys_read32(REG_STATUS) & 0x2)) {
				k_sleep(K_TICKS(1));
			}
			c[3] = k_cycle_get_32();   /* 推論が終わった */
			r.run_us = (uint32_t)((uint64_t)(c[3] - c0) * 1000000U /
					      sys_clock_hw_cycles_per_sec());
			r.digit = sys_read32(REG_DIGIT) & 0xF;
			for (int i = 0; i < NOUT; i++) {
				sys_write32(i, REG_SEL);
				r.score[i] = (int32_t)sys_read32(REG_SCORE);
			}
			c[4] = k_cycle_get_32();   /* スコアを読み終えた */
			n_done++;
			run_sum_us += r.run_us;
			run_min_us = MIN(run_min_us, r.run_us);
			run_max_us = MAX(run_max_us, r.run_us);
		}
		img_fill = 0;
		busy = false;
		rpmsg_send(&cnn_ept, &r, sizeof(r));
		if (r.status == 0) {
			c[5] = k_cycle_get_32();   /* 返事を送り終えた */
			for (int i = 0; i < T_N; i++) {
				t_sum[i] += c[i + 1] - c[i];
			}
		}
	}
}
K_THREAD_DEFINE(cnn_tid, 1024, cnn_thread, NULL, NULL, NULL, 5, 0, 0);

int cnn_rpmsg_init(struct rpmsg_device *rpdev)
{
	return rpmsg_create_ept(&cnn_ept, rpdev, "rpmsg-raw", CNN_EPT_ADDR, RPMSG_ADDR_ANY, cnn_cb,
				NULL);
}

/* ---- shell: cnn stats ---- */
static int cmd_stats(const struct shell *sh, size_t argc, char **argv)
{
	shell_print(sh, "推論 %u 枚 / 形式違い %u / PL が CNN でない %u", n_done, n_bad_msg, n_not_cnn);
	if (n_done) {
		shell_print(sh, "PL の推論時間 最小 %u us 平均 %u us 最大 %u us", run_min_us,
			    (uint32_t)(run_sum_us / n_done), run_max_us);
		/* 内訳 (1 枚あたりの平均)。起床 = 最後の断片を受けてから推論スレッドが動くまで */
		uint64_t hz = sys_clock_hw_cycles_per_sec();

		for (int i = 0; i < T_N; i++) {
			shell_print(sh, "  %s %u us", t_name[i],
				    (uint32_t)(t_sum[i] * 1000000U / hz / n_done));
		}
	}
	return 0;
}

SHELL_STATIC_SUBCMD_SET_CREATE(sub_cnn,
	SHELL_CMD(stats, NULL, "Linux から頼まれた推論の統計", cmd_stats),
	SHELL_SUBCMD_SET_END);
SHELL_CMD_REGISTER(cnn, &sub_cnn, "PL の CNN (RPMsg で Linux から依頼)", NULL);
```

## src/r2r.c
```c
// -----------------------------------------------------------------------------
// r2r.c -- R5_0 と R5_1 が Linux を通さず直接話す (R5_0 側)
//
//   2 つの R5 の間には専用の IPI がある (Zephyr の DT では rpu0_rpu1_mailbox / rpu1_rpu0_mailbox)。
//   送る側は IPI 専用バッファ (0xFF990000〜、相手ごとに 32 バイト) に書いてから合図を打ち、
//   受ける側は割り込みの中で読む。Linux 用の受け口 (rpu0_apu_mailbox) と同じ割り込み (33) を
//   共有するが、ドライバが相手ごとのビットで区別する。
//
//   shell の r2r ping [回数]: 番号を R5_1 に送り、R5_1 がそのまま送り返すまでの往復を測る
//   (R5_1 側は apps/rpmsg_r5_1/src/main.c の r2r_cb)
// -----------------------------------------------------------------------------
#include <zephyr/kernel.h>
#include <zephyr/device.h>
#include <zephyr/drivers/ipm.h>
#include <zephyr/shell/shell.h>
#include <stdlib.h>

#include "r2r_shm.h"   /* apps/common: 伝言の形と共有 DDR の輪バッファ */
#include "ipi_early_clear.h"

/* 前回の R5_0 が残した IPI の合図で起動が止まらないよう、割り込み解禁前に消す (ipi_early_clear.h) */
IPI_EARLY_CLEAR(DT_NODELABEL(rpu0_ipi));

static const struct device *const r2r = DEVICE_DT_GET(DT_NODELABEL(rpu0_rpu1_mailbox));

static K_SEM_DEFINE(pong_sem, 0, 1);
static volatile uint32_t pong_val;

#define NPING_MAX 1000
static uint16_t rtt_cyc[NPING_MAX];   /* 1 往復のサイクル数 (100MHz なので 1 = 10ns) */

void rpmsg_poke(void);   /* main.c: Linux の合図を消されても受信リングを見に行かせる */

/* R5_1 からの IPI (割り込みの中) */
static void r2r_cb(const struct device *dev, void *ctx, uint32_t id, volatile void *data)
{
	/* data はドライバ内の struct xlnx_ipi_data { size_t len; void *user_data; uint8_t data[]; }
	 * (drivers/ipm/ipm_xlnx_ipi.c、公開ヘッダなし)。R5 は 32 ビットなので中身は先頭から 8 バイト目
	 */
	const volatile struct r2r_msg *m = (const volatile struct r2r_msg *)((volatile uint8_t *)data + 8);

	rpmsg_poke();   /* ドライバがこの合図を消す時に Linux の合図も消しうる (rpmsg_r5_1 の main.c の r2r_cb) */
	if (m->type == R2R_PING) {
		pong_val = m->val;
		k_sem_give(&pong_sem);
	}
}

/* R5_1 に「輪バッファを rd まで読んだので足して」と知らせる (audio_rpmsg.c の 1ms ごとの書き足しから) */
void r2r_kick(uint32_t rd)
{
	struct r2r_msg m = {R2R_KICK, rd};

	ipm_send(r2r, 0, 0, &m, sizeof(m));
}

static int r2r_init(void)
{
	if (!device_is_ready(r2r)) {
		return -ENODEV;
	}
	ipm_register_callback(r2r, r2r_cb, NULL);
	return ipm_set_enabled(r2r, 1);
}
SYS_INIT(r2r_init, APPLICATION, 90);

static int cmd_ping(const struct shell *sh, size_t argc, char **argv)
{
	uint32_t n = argc > 1 ? MIN(strtoul(argv[1], NULL, 10), NPING_MAX) : 100;
	uint32_t bad = 0, lost = 0, ok = 0;
	uint64_t sum = 0;

	for (uint32_t i = 1; i <= n; i++) {
		k_sem_reset(&pong_sem);
		uint32_t c0 = k_cycle_get_32();

		struct r2r_msg m = {R2R_PING, i};

		ipm_send(r2r, 0, 0, &m, sizeof(m));
		if (k_sem_take(&pong_sem, K_MSEC(10))) {
			lost++;
			continue;
		}
		uint32_t c = k_cycle_get_32() - c0;

		if (pong_val != i) {
			bad++;
			continue;
		}
		rtt_cyc[ok++] = (uint16_t)MIN(c, UINT16_MAX);
		sum += c;
	}
	if (!ok) {
		shell_print(sh, "返事なし %u 回 (R5_1 は動いている?)", lost);
		return 0;
	}
	/* 中央値を出すため並べる (挿入ソート。1000 個なら一瞬) */
	for (uint32_t i = 1; i < ok; i++) {
		uint16_t v = rtt_cyc[i];
		int j = i - 1;

		while (j >= 0 && rtt_cyc[j] > v) {
			rtt_cyc[j + 1] = rtt_cyc[j];
			j--;
		}
		rtt_cyc[j + 1] = v;
	}
	uint32_t hz = sys_clock_hw_cycles_per_sec() / 1000000U;   /* 1us あたりのサイクル */

	shell_print(sh, "R5_0 → R5_1 → R5_0: %u 往復 / 違う値 %u / 返事なし %u", ok, bad, lost);
	shell_print(sh, "最小 %u.%02u us  中央 %u.%02u us  平均 %u.%02u us  最大 %u.%02u us",
		    rtt_cyc[0] / hz, rtt_cyc[0] % hz * 100 / hz,
		    rtt_cyc[ok / 2] / hz, rtt_cyc[ok / 2] % hz * 100 / hz,
		    (uint32_t)(sum / ok) / hz, (uint32_t)(sum / ok) % hz * 100 / hz,
		    rtt_cyc[ok - 1] / hz, rtt_cyc[ok - 1] % hz * 100 / hz);
	return 0;
}

SHELL_STATIC_SUBCMD_SET_CREATE(sub_r2r,
	SHELL_CMD(ping, NULL, "R5_1 との往復を測る [回数 (最大 1000)]", cmd_ping),
	SHELL_SUBCMD_SET_END);
SHELL_CMD_REGISTER(r2r, &sub_r2r, "R5_1 と直接話す (Linux を通さない IPI)", NULL);
```

## src/synth.c
```c
// -----------------------------------------------------------------------------
// synth.c -- R5 で音を作る (音源ファイルなし)。audio_rpmsg.c の書き足しスレッドから呼ばれる
//
//   Linux は「音の高さ・長さ・強さ」だけを送る。R5 が 1 標本ずつ波形を計算して PL の FIFO に書く。
//     - 同時に 8 音。波形は 正弦 / 矩形 / のこぎり / 三角
//     - 高さは位相 (32 ビット) を毎標本 inc ずつ足すだけ (足し算があふれて 1 周する = 1 周期)
//     - 音の形 (包絡): 2ms で立ち上がる → 長さの間はゆっくり減る → 長さが過ぎたら速く消える
//     - 楽譜: (時刻, 音) の列をためておき、標本の数で時刻を数えて鳴らす。テンポは R5 の
//       標本数だけで決まるので、Linux の負荷に左右されない
//   計算は整数だけ (浮動小数点は起動時の表作りだけ)。正弦の表は BTCM (変数領域) に置く
// -----------------------------------------------------------------------------
#include <zephyr/kernel.h>
#include <zephyr/sys/sys_io.h>
#include "synth.h"

/* 標本の速さ (Hz)。既定は PL の I2S (12.5MHz / 256 = 48828.125)。HDMI に出すときは 48000 (synth_set_fs) */
static uint32_t fs = 48828;
#define NVOICE    8
#define ATTACK    98           /* 立ち上がり 約 2ms (標本) */
#define ENV_MAX   (1 << 24)    /* 包絡の最大 (Q24) */
#define ENV_OFF   (1 << 12)    /* ここまで減ったら音を止める */
#define SCORE_MAX 256

struct voice {
	uint32_t phase, inc;
	int32_t env, peak;     /* Q24 */
	uint32_t age;          /* 鳴り始めてからの標本数 */
	uint32_t len;          /* この標本数を過ぎたら速く消す */
	uint32_t t_rx;         /* 命令を受けた時刻 (サイクル)。最初に書いた時に遅れを測る。0 = 測定済み */
	bool on;
};

struct ev {
	uint32_t t;            /* 鳴らす時刻 (標本) */
	uint8_t note, vel;
	uint16_t len_ms;
};

static struct voice v[NVOICE];
static int16_t sine[256];
static uint32_t inc12[12];     /* MIDI 120〜131 (C9〜B9) の inc。低い音は右シフトで作る */
static uint8_t wave;           /* 0 正弦 1 矩形 2 のこぎり 3 三角 */

static struct ev score[SCORE_MAX];
static uint32_t n_score, score_pos;
static bool score_run;
static uint32_t clk;           /* 標本の時計 (楽譜用) */

struct synth_stats synth_st;

void synth_init(void)
{
	/* 正弦の表: 単位円を 2π/256 ずつ回す (sin/cos を使わずに済む) */
	float x = 1.0f, y = 0.0f;
	const float c = 0.99969881869620425f, s = 0.024541228522912288f;

	for (int i = 0; i < 256; i++) {
		sine[i] = (int16_t)(y * 32767.0f);
		float nx = x * c - y * s;

		y = x * s + y * c;
		x = nx;
	}
	synth_set_fs(fs);
}

/* 標本の速さを変え、高さの表 (inc12) を作り直す。I2S は 48828、HDMI は 48000 (段6) */
void synth_set_fs(uint32_t hz)
{
	/* I2S の正確な値は 48828.125 なので、48828 のときだけ端数を足す */
	float rate = (hz == 48828U) ? 48828.125f : (float)hz;
	/* 半音ずつ 2^(1/12) 倍。MIDI 120 (C9) = 440 × 2^(51/12) ≒ 8372.018Hz */
	float f = 8372.018f;

	fs = hz;
	for (int k = 0; k < 12; k++) {
		inc12[k] = (uint32_t)(f / rate * 4294967296.0f);
		f *= 1.0594630943592953f;
	}
}

uint32_t synth_get_fs(void)
{
	return fs;
}

static uint32_t note_inc(uint8_t n)
{
	if (n > 131) {
		n = 131;
	}
	/* 同じ音名の C9〜B9 から、オクターブの差だけ右シフト (1 オクターブ下 = 周波数半分) */
	return inc12[n % 12] >> ((120 + n % 12 - n) / 12);
}

void synth_wave(uint8_t w)
{
	wave = w & 3;
}

/* measure: Linux からの命令なら遅れを測る (楽譜の音は測らない) */
static void note_start(uint8_t note, uint16_t len_ms, uint8_t vel, bool measure)
{
	/* 空いている声を使う。なければ一番小さくなった声を奪う */
	int pick = 0;

	for (int i = 0; i < NVOICE; i++) {
		if (!v[i].on) {
			pick = i;
			break;
		}
		if (v[i].env < v[pick].env) {
			pick = i;
		}
	}
	struct voice *p = &v[pick];

	p->phase = 0;
	p->inc = note_inc(note);
	p->peak = (int32_t)((uint32_t)ENV_MAX / 127 * MIN(vel, 127));
	p->env = 0;
	p->age = 0;
	p->len = (uint32_t)len_ms * fs / 1000U;
	p->t_rx = measure ? (k_cycle_get_32() | 1) : 0;
	p->on = true;
	synth_st.n_notes++;
}

void synth_note(uint8_t note, uint16_t len_ms, uint8_t vel)
{
	note_start(note, len_ms, vel, true);
}

void synth_score_clear(void)
{
	n_score = 0;
	score_run = false;
}

int synth_score_add(uint32_t t_ms, uint8_t note, uint16_t len_ms, uint8_t vel)
{
	if (n_score >= SCORE_MAX) {
		return -1;
	}
	score[n_score++] = (struct ev){(uint32_t)((uint64_t)t_ms * fs / 1000U), note, vel, len_ms};
	return 0;
}

void synth_score_start(void)
{
	/* 時刻順に並べる (挿入ソート。同時刻は入れた順のまま)。synth_next は先頭から順に「時刻が来たか」を
	 * 見るので、並んでいないと後ろに入れた音 (例: メロディの後にまとめて入れた低音) が全部最後に
	 * 一斉に鳴ってしまう (段3〜段5 のきらきら星で最後が爆発音になっていた原因)
	 */
	for (uint32_t i = 1; i < n_score; i++) {
		struct ev e = score[i];
		uint32_t j = i;

		while (j > 0 && score[j - 1].t > e.t) {
			score[j] = score[j - 1];
			j--;
		}
		score[j] = e;
	}
	clk = 0;
	score_pos = 0;
	score_run = n_score > 0;
}

bool synth_score_running(void)
{
	return score_run;
}

uint32_t synth_active(void)
{
	uint32_t n = 0;

	for (int i = 0; i < NVOICE; i++) {
		n += v[i].on;
	}
	return n;
}

static int32_t osc(uint32_t ph)
{
	switch (wave) {
	case 0:
		return sine[ph >> 24];
	case 1:
		return (ph & 0x80000000u) ? -24000 : 24000;   /* 矩形は耳に強いので少し小さく */
	case 2:
		return (int32_t)(ph >> 16) - 32768;
	default: {
		/* 0〜65535。段3〜段5 は ph >> 15 (0〜131071) と誤っていて、波が約 5 倍に振れて割れていた */
		int32_t t = (int32_t)(ph >> 16);

		return t < 32768 ? t * 2 - 32768 : 32767 - (t - 32768) * 2;
	}
	}
}

/* 遅れを測る (1 区切りの頭で 1 回)。level = 今作る標本が鳴るまでに先に鳴る標本の数
 * 遅れ = 命令を受けてから作り始めるまで + level 標本ぶん (R5_0 では FIFO の残量、R5_1 では
 * 輪バッファの残り + FIFO の残量)
 */
void synth_measure(uint32_t level)
{
	uint32_t now = k_cycle_get_32();

	for (int i = 0; i < NVOICE; i++) {
		if (v[i].on && v[i].t_rx) {
			uint32_t us = (uint32_t)((uint64_t)(now - v[i].t_rx) * 1000000U /
						 sys_clock_hw_cycles_per_sec()) +
				      (uint32_t)((uint64_t)level * 1000000U / fs);

			synth_st.lat_max_us = MAX(synth_st.lat_max_us, us);
			synth_st.lat_sum_us += us;
			synth_st.n_lat++;
			v[i].t_rx = 0;
		}
	}
}

/* 1 標本作る (全部の声を足し合わせ、16 ビットに収める) */
int32_t synth_next(void)
{
	/* 楽譜: 時刻が来た音符を鳴らす (標本単位で正確) */
	while (score_run && score_pos < n_score && score[score_pos].t <= clk) {
		struct ev *e = &score[score_pos++];

		note_start(e->note, e->len_ms, e->vel, false);
	}
	clk++;

	int32_t mix = 0;

	for (int i = 0; i < NVOICE; i++) {
		struct voice *p = &v[i];

		if (!p->on) {
			continue;
		}
		if (p->age < ATTACK) {
			p->env = p->peak / ATTACK * (int32_t)(p->age + 1);
		} else if (p->age < p->len) {
			p->env -= p->env >> 13;   /* 長さの間: 時定数 約 168ms でゆっくり減る */
		} else {
			p->env -= p->env >> 8;    /* 長さの後: 時定数 約 5ms で消える */
			if (p->env < ENV_OFF) {
				p->on = false;
				continue;
			}
		}
		p->age++;
		mix += (int32_t)(((int64_t)osc(p->phase) * p->env) >> 26);   /* 1 音で最大 ±8192 */
		p->phase += p->inc;
	}
	return CLAMP(mix, -32768, 32767);
}

/* 1 区切り作り終えたら呼ぶ: 楽譜を最後まで鳴らし、音が全部消えたら終わり */
void synth_block_end(void)
{
	if (score_run && score_pos >= n_score && synth_active() == 0) {
		score_run = false;
	}
}

/* R5_0 用: n 標本を作って PL の FIFO に直接書く。level = 書き始める時点の FIFO の残量 */
void synth_render(uint32_t n, uint32_t level)
{
	synth_measure(level);
	for (uint32_t k = 0; k < n; k++) {
		int32_t s = synth_next();

		/* 左右に同じ値 (モノラル) */
		sys_write32(((uint32_t)(uint16_t)s << 16) | (uint16_t)s, SYNTH_REG_DATA);
	}
	synth_block_end();
}
```

## src/synth.h
```c
/* synth.h -- R5 で音を作る (synth.c)。audio_rpmsg.c から使う */
#ifndef SYNTH_H
#define SYNTH_H

#include <stdbool.h>
#include <stdint.h>

#define SYNTH_REG_DATA 0xA0000000UL   /* PL の FIFO の DATA (audio_rpmsg.c の REG_DATA と同じ) */

struct synth_stats {
	uint32_t n_notes;      /* 鳴らした音の数 (楽譜の音も含む) */
	uint32_t n_lat;        /* 遅れを測った回数 (Linux からの音だけ) */
	uint32_t lat_max_us;   /* 命令を受けてから音が出るまでの最長 */
	uint64_t lat_sum_us;
};
extern struct synth_stats synth_st;

void synth_init(void);
void synth_wave(uint8_t w);
void synth_set_fs(uint32_t hz);   /* 標本の速さ: I2S 48828 / HDMI 48000 */
uint32_t synth_get_fs(void);
void synth_note(uint8_t note, uint16_t len_ms, uint8_t vel);
void synth_score_clear(void);
int synth_score_add(uint32_t t_ms, uint8_t note, uint16_t len_ms, uint8_t vel);
void synth_score_start(void);
bool synth_score_running(void);
uint32_t synth_active(void);
void synth_render(uint32_t n, uint32_t level);   /* R5_0 用: n 標本を作って FIFO に書く */
/* R5_1 用 (輪バッファに書くとき): 頭で synth_measure、1 標本ずつ synth_next、最後に synth_block_end */
void synth_measure(uint32_t level);
int32_t synth_next(void);
void synth_block_end(void);

#endif
```
