/*
 * KV260 の PetaLinux に R5 の remoteproc を足すデバイスツリーオーバーレイ (段1: TCM だけで起動)
 *
 * Linux の起動中に configfs で当てる (再起動すれば消える。SD カードも U-Boot も変えない):
 *   dtc -I dts -O dtb -o r5_rproc.dtbo r5_rproc.dtso
 *   sudo mkdir /sys/kernel/config/device-tree/overlays/r5
 *   sudo sh -c 'cat r5_rproc.dtbo > /sys/kernel/config/device-tree/overlays/r5/dtbo'
 *   → /sys/class/remoteproc/remoteproc0, 1 ができる (R5_0, R5_1)
 *
 * 中身はカーネル 6.12 の Documentation/devicetree/bindings/remoteproc/xlnx,zynqmp-r5fss.yaml の
 * 分割モードの例そのまま。電源ドメインの番号は include/dt-bindings/power/xlnx-zynqmp-power.h
 * (PD_RPU_0=7, PD_RPU_1=8, PD_R5_0_ATCM=15, PD_R5_0_BTCM=16, PD_R5_1_ATCM=17, PD_R5_1_BTCM=18)。
 *
 * memory-region (DDR のメモリ予約) は入れない。予約は起動時にしか効かず、起動後のオーバーレイで
 * 足しても R5 のドライバが見つけられないため。代わりに Zephyr を ATCM (64KB) に収める。
 * mboxes (IPI) も段1では使わない。
 */
/dts-v1/;
/plugin/;

/ {
	fragment@0 {
		target-path = "/";
		__overlay__ {
			remoteproc@ffe00000 {
				compatible = "xlnx,zynqmp-r5fss";
				xlnx,cluster-mode = <0>;   /* 分割モード (R5_0 と R5_1 が別々) */
				xlnx,tcm-mode = <0>;

				#address-cells = <2>;
				#size-cells = <2>;
				/* R5 から見た TCM の番地 → グローバル番地 */
				ranges = <0x0 0x0 0x0 0xffe00000 0x0 0x10000>,
					 <0x0 0x20000 0x0 0xffe20000 0x0 0x10000>,
					 <0x1 0x0 0x0 0xffe90000 0x0 0x10000>,
					 <0x1 0x20000 0x0 0xffeb0000 0x0 0x10000>;

				r5f@0 {
					compatible = "xlnx,zynqmp-r5f";
					reg = <0x0 0x0 0x0 0x10000>, <0x0 0x20000 0x0 0x10000>;
					reg-names = "atcm0", "btcm0";
					power-domains = <&zynqmp_firmware 7>,
							<&zynqmp_firmware 15>,
							<&zynqmp_firmware 16>;
				};

				/* 分割モードではドライバが子ノードを 2 つ要求する。使うのは R5_0 だけ */
				r5f@1 {
					compatible = "xlnx,zynqmp-r5f";
					reg = <0x1 0x0 0x0 0x10000>, <0x1 0x20000 0x0 0x10000>;
					reg-names = "atcm0", "btcm0";
					power-domains = <&zynqmp_firmware 8>,
							<&zynqmp_firmware 17>,
							<&zynqmp_firmware 18>;
				};
			};
		};
	};
};
