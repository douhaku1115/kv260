/*
 * 案7ベアメタル版: シリアル受信 → HDMI文字表示
 *
 * 公式DPDMAサンプル(xdpdma_video_example)をベースに、
 * UART1受信 + 8x16フォント描画を追加したもの。
 *
 * ■ システム構成
 *   PC (tio /dev/ttyUSB1) --[UART 115200bps]--> KV260 PS UART1
 *                                                    |
 *                                            DDRフレームバッファ (Frame配列)
 *                                                    |
 *                                            PS DisplayPort (non-live) → HDMI
 *
 * ■ 公式サンプルからの変更点
 *   - GraphicsOverlay(): カラーバー → 黒画面クリア に変更
 *   - UART1初期化 + ポーリング受信ループ追加
 *   - 8x16ビットマップフォント + フレームバッファ描画関数追加
 *   - main()の末尾に無限ループ追加 (UART受信 → HDMI描画)
 *
 * ■ 変更していないファイル
 *   - xdpdma_video_example.h: 型定義、関数プロトタイプ (そのまま)
 *   - xdppsu_interrupt.c: HPDハンドラ、リンクトレーニング (そのまま)
 *
 * ■ 処理の流れ
 *   main()
 *     ├─ キャッシュ無効化
 *     ├─ InitUart()           ← UART1 115200bps初期化
 *     ├─ DpdmaVideoExample()
 *     │    ├─ InitRunConfig()          ← 1920x1080, 5.4Gbps, 2lane
 *     │    ├─ InitDpDmaSubsystem()     ← DP/AVBuf/DPDMA初期化
 *     │    ├─ GraphicsOverlay()        ← 黒画面クリア (変更箇所)
 *     │    ├─ FrameBuffer設定
 *     │    └─ SetupInterrupts()        ← HPD(151) + DPDMA VSYNC(154)
 *     │         ↓ HPDイベント発生
 *     │         DpPsu_IsrHpdEvent → DpPsu_Run → リンクトレーニング → 映像出力開始
 *     │
 *     ├─ 起動メッセージ表示
 *     └─ メインループ: UART受信 → fb_put_char → HDMI表示
 */

/***************************** Include Files *********************************/

#include "xil_exception.h"
#include "xil_printf.h"
#include "xil_cache.h"
#include "xdpdma_video_example.h"
#include "xuartps.h"

/************************** Constant Definitions *****************************/
#ifndef SDT
#define DPPSU_DEVICE_ID		XPAR_PSU_DP_DEVICE_ID
#define AVBUF_DEVICE_ID		XPAR_PSU_DP_DEVICE_ID
#define DPDMA_DEVICE_ID		XPAR_XDPDMA_0_DEVICE_ID
#define INTC_DEVICE_ID		XPAR_SCUGIC_0_DEVICE_ID
#define DPPSU_INTR_ID		151
#define DPDMA_INTR_ID		154

#define DPPSU_BASEADDR		XPAR_PSU_DP_BASEADDR
#define AVBUF_BASEADDR		XPAR_PSU_DP_BASEADDR
#define DPDMA_BASEADDR		XPAR_PSU_DPDMA_BASEADDR

#define UART_DEVICE_ID		XPAR_XUARTPS_1_DEVICE_ID
#else
#define DPPSU_BASEADDR		XPAR_XDPPSU_0_BASEADDR
#define AVBUF_BASEADDR		XPAR_XDPPSU_0_BASEADDR
#define DPDMA_BASEADDR		XPAR_XDPDMA_0_BASEADDR
#define INTC_BASEADDR       XPAR_XSCUGIC_0_BASEADDR
#define UART_BASEADDR		XPAR_XUARTPS_0_BASEADDR
#endif

#define BUFFERSIZE			1920 * 1080 * 4		/* HTotal * VTotal * BPP */
#define LINESIZE			1920 * 4			/* HTotal * BPP */
#define STRIDE				LINESIZE			/* The stride value should
													be aligned to 256*/

/* 画面・フォント設定 */
#define HRES       1920
#define VRES       1080
#define CHAR_W     8      /* フォント幅 (ピクセル) */
#define CHAR_H     16     /* フォント高さ (ピクセル) */
#define COLS       (HRES / CHAR_W)   /* 240桁 */
#define ROWS       (VRES / CHAR_H)   /* 67行 */

/* 色定義 (RGBA8888) */
#define COLOR_GREEN  0xFF00FF00
#define COLOR_BLACK  0xFF000000

/************************** Variable Declarations ***************************/
XDpDma DpDma;
XDpPsu DpPsu;
XAVBuf AVBuf;
XScuGic Intr;
Run_Config RunCfg;

u8 Frame[BUFFERSIZE] __attribute__ ((__aligned__(256)));
XDpDma_FrameBuffer FrameBuffer;

static XUartPs Uart;

/* カーソル位置 */
static int cur_col = 0;
static int cur_row = 0;

/* フレームバッファをu32としてアクセスするポインタ */
static u32 *fb;

/* ================================================================
 * 8x16 ビットマップフォント (ASCII 0x20-0x7E)
 * ================================================================
 * 各文字は16バイト (16行 x 8ピクセル, 1bit/pixel)。
 * MSB(bit7)が左端ピクセル、LSB(bit0)が右端ピクセル。
 *
 * 例: 'A' = { 0x00,0x00,0x10,0x38,0x6C,0xC6,0xC6,0xFE,
 *              0xC6,0xC6,0xC6,0xC6,0x00,0x00,0x00,0x00 }
 *
 *   0x10 = ...#....
 *   0x38 = ..###...
 *   0x6C = .##.##..
 *   0xC6 = ##...##.
 *   0xFE = #######.  <- 横棒
 *   0xC6 = ##...##.
 */
static const u8 font_8x16[95][16] = {
    {0x00,0x00,0x00,0x00,0x00,0x00,0x00,0x00,0x00,0x00,0x00,0x00,0x00,0x00,0x00,0x00}, /* ' ' */
    {0x00,0x00,0x18,0x3C,0x3C,0x3C,0x18,0x18,0x18,0x00,0x18,0x18,0x00,0x00,0x00,0x00}, /* '!' */
    {0x00,0x66,0x66,0x66,0x24,0x00,0x00,0x00,0x00,0x00,0x00,0x00,0x00,0x00,0x00,0x00}, /* '"' */
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    {0x00,0x00,0x00,0x00,0x00,0x76,0xDC,0x00,0x00,0x00,0x00,0x00,0x00,0x00,0x00,0x00}, /* '~' */
};

/**************************** Type Definitions *******************************/

/* ================================================================
 * フレームバッファ描画関数
 * ================================================================ */

/* 画面全体を黒でクリア */
static void fb_clear(void)
{
    for (int i = 0; i < HRES * VRES; i++)
        fb[i] = COLOR_BLACK;
    cur_col = 0;
    cur_row = 0;
}

/* 1文字をフレームバッファに描画 */
static void fb_draw_char(char ch, int col, int row)
{
    const u8 *glyph;

    if (ch >= 0x20 && ch <= 0x7E)
        glyph = font_8x16[ch - 0x20];
    else
        glyph = font_8x16[0];

    int base_x = col * CHAR_W;
    int base_y = row * CHAR_H;
    for (int y = 0; y < CHAR_H; y++) {
        u8 bits = glyph[y];
        for (int x = 0; x < CHAR_W; x++) {
            u32 color = (bits & (0x80 >> x)) ? COLOR_GREEN : COLOR_BLACK;
            fb[(base_y + y) * HRES + base_x + x] = color;
        }
    }
}

/* 画面を1文字行分(16ピクセル)上にスクロール */
static void fb_scroll_up(void)
{
    int line_pixels = HRES * CHAR_H;
    for (int i = 0; i < HRES * VRES - line_pixels; i++)
        fb[i] = fb[i + line_pixels];

    for (int i = HRES * VRES - line_pixels; i < HRES * VRES; i++)
        fb[i] = COLOR_BLACK;
}

/* 1文字出力（カーソル管理・スクロール付き） */
static void fb_put_char(char ch)
{
    if (ch == '\n' || ch == '\r') {
        cur_col = 0;
        cur_row++;
    } else if (ch == '\x08' || ch == '\x7f') {
        if (cur_col > 0) {
            cur_col--;
            fb_draw_char(' ', cur_col, cur_row);
        }
    } else {
        fb_draw_char(ch, cur_col, cur_row);
        cur_col++;
    }

    if (cur_col >= COLS) {
        cur_col = 0;
        cur_row++;
    }
    if (cur_row >= ROWS) {
        fb_scroll_up();
        cur_row = ROWS - 1;
    }
}

/* 文字列出力 */
static void fb_put_string(const char *s)
{
    while (*s)
        fb_put_char(*s++);
}

/* ================================================================
 * UART初期化
 * ================================================================ */
static int InitUart(void)
{
    XUartPs_Config *Cfg;
#ifndef SDT
    Cfg = XUartPs_LookupConfig(UART_DEVICE_ID);
#else
    Cfg = XUartPs_LookupConfig(UART_BASEADDR);
#endif
    if (!Cfg) return XST_FAILURE;

    int Status = XUartPs_CfgInitialize(&Uart, Cfg, Cfg->BaseAddress);
    if (Status != XST_SUCCESS) return XST_FAILURE;

    XUartPs_SetBaudRate(&Uart, 115200);
    XUartPs_SetOperMode(&Uart, XUARTPS_OPER_MODE_NORMAL);

    return XST_SUCCESS;
}

/*****************************************************************************/
/**
*
* Main function to call the DPDMA Video example.
*
******************************************************************************/
int main()
{
	int Status;

	Xil_DCacheDisable();
	Xil_ICacheDisable();

	xil_printf("\r\n=== Serial Display (Bare-metal, non-live DP) ===\r\n");

	/* UART1初期化 */
	Status = InitUart();
	if (Status != XST_SUCCESS) {
		xil_printf("UART init failed\r\n");
		return XST_FAILURE;
	}
	xil_printf("UART1 OK (115200 8N1)\r\n");

	/* DisplayPort初期化 + 割り込み設定 */
	Status = DpdmaVideoExample(&RunCfg);
	if (Status != XST_SUCCESS) {
		xil_printf("DPDMA Video Example Failed\r\n");
		return XST_FAILURE;
	}

	xil_printf("DP initialized, waiting for HPD...\r\n");

	/*
	 * HPD割り込みが発生するまで少し待つ。
	 * SetupInterrupts()でHPD割り込みが有効になった時点で
	 * HDMIケーブルが接続されていれば自動的にHPDイベントが発生し、
	 * DpPsu_IsrHpdEvent → DpPsu_Run → リンクトレーニング → 映像出力開始
	 * となる。
	 */
	sleep(2);

	/* HDMIに起動メッセージ表示 */
	fb_put_string("Serial Display Ready (bare-metal)\n");
	fb_put_string("Waiting for UART1 input...\n");
	fb_put_string("---\n");

	xil_printf("Ready. Type in tio to display on HDMI.\r\n");

	/*
	 * メインループ: UART1受信 → HDMI描画
	 * XUartPs_IsReceiveData(): 受信FIFOにデータがあるか確認（ノンブロッキング）
	 * XUartPs_RecvByte(): 1バイト受信
	 */
	while (1) {
		if (XUartPs_IsReceiveData(Uart.Config.BaseAddress)) {
			u8 byte = XUartPs_RecvByte(Uart.Config.BaseAddress);
			char ch = (byte < 128) ? (char)byte : '?';
			fb_put_char(ch);
		}
	}

    return XST_SUCCESS;
}

/*****************************************************************************/
/**
*
* The purpose of this function is to illustrate how to use the XDpDma device
* driver in Graphics overlay mode.
*
******************************************************************************/
int DpdmaVideoExample(Run_Config *RunCfgPtr)

{
	u32 Status;
	/* Initialize the application configuration */
	InitRunConfig(RunCfgPtr);
	Status = InitDpDmaSubsystem(RunCfgPtr);
	if (Status != XST_SUCCESS) {
				return XST_FAILURE;
	}

	/* 画面を黒でクリア（公式サンプルではカラーバーを描画していた箇所） */
	GraphicsOverlay(Frame, RunCfgPtr);

	/* Populate the FrameBuffer structure with the frame attributes */
	FrameBuffer.Address = (INTPTR)Frame;
	FrameBuffer.Stride = STRIDE;
	FrameBuffer.LineSize = LINESIZE;
	FrameBuffer.Size = BUFFERSIZE;

	SetupInterrupts(RunCfgPtr);

	return XST_SUCCESS;
}

/*****************************************************************************/
/**
*
* The purpose of this function is to initialize the application configuration.
*
******************************************************************************/
void InitRunConfig(Run_Config *RunCfgPtr)
{
	/* Initial configuration parameters. */
		RunCfgPtr->DpPsuPtr   = &DpPsu;
		RunCfgPtr->IntrPtr   = &Intr;
		RunCfgPtr->AVBufPtr  = &AVBuf;
		RunCfgPtr->DpDmaPtr  = &DpDma;
		RunCfgPtr->VideoMode = XVIDC_VM_1920x1080_60_P;
		RunCfgPtr->Bpc		 = XVIDC_BPC_8;
		RunCfgPtr->ColorEncode			= XDPPSU_CENC_RGB;
		RunCfgPtr->UseMaxCfgCaps		= 1;
		RunCfgPtr->LaneCount			= LANE_COUNT_2;
		RunCfgPtr->LinkRate				= LINK_RATE_540GBPS;
		RunCfgPtr->EnSynchClkMode		= 0;
		RunCfgPtr->UseMaxLaneCount		= 1;
		RunCfgPtr->UseMaxLinkRate		= 1;
}

/*****************************************************************************/
/**
*
* The purpose of this function is to initialize the DP Subsystem (XDpDma,
* XAVBuf, XDpPsu)
*
******************************************************************************/
int InitDpDmaSubsystem(Run_Config *RunCfgPtr)
{
	u32 Status;
	XDpPsu		*DpPsuPtr = RunCfgPtr->DpPsuPtr;
	XDpPsu_Config	*DpPsuCfgPtr;
	XAVBuf		*AVBufPtr = RunCfgPtr->AVBufPtr;
	XDpDma_Config *DpDmaCfgPtr;
	XDpDma		*DpDmaPtr = RunCfgPtr->DpDmaPtr;


	/* Initialize DisplayPort driver. */
#ifndef SDT
	DpPsuCfgPtr = XDpPsu_LookupConfig(DPPSU_DEVICE_ID);
#else
	DpPsuCfgPtr = XDpPsu_LookupConfig(DPPSU_BASEADDR);
#endif
	XDpPsu_CfgInitialize(DpPsuPtr, DpPsuCfgPtr, DpPsuCfgPtr->BaseAddr);
	/* Initialize Video Pipeline driver */
#ifndef SDT
	XAVBuf_CfgInitialize(AVBufPtr, DpPsuPtr->Config.BaseAddr, AVBUF_DEVICE_ID);
#else
	XAVBuf_CfgInitialize(AVBufPtr, DpPsuPtr->Config.BaseAddr);
#endif

	/* Initialize the DPDMA driver */
#ifndef SDT
	DpDmaCfgPtr = XDpDma_LookupConfig(DPDMA_DEVICE_ID);
#else
	DpDmaCfgPtr = XDpDma_LookupConfig(DPDMA_BASEADDR);
#endif
	XDpDma_CfgInitialize(DpDmaPtr,DpDmaCfgPtr);

	/* Initialize the DisplayPort TX core. */
	Status = XDpPsu_InitializeTx(DpPsuPtr);
	if (Status != XST_SUCCESS) {
		return XST_FAILURE;
	}
	/* Set the format graphics frame for DPDMA*/
	Status = XDpDma_SetGraphicsFormat(DpDmaPtr, RGBA8888);
	if (Status != XST_SUCCESS) {
			return XST_FAILURE;
	}
	/* Set the format graphics frame for Video Pipeline*/
	Status = XAVBuf_SetInputNonLiveGraphicsFormat(AVBufPtr, RGBA8888);
	if (Status != XST_SUCCESS) {
			return XST_FAILURE;
	}
	/* Set the QOS for Video */
	XDpDma_SetQOS(RunCfgPtr->DpDmaPtr, 11);
	/* Enable the Buffers required by Graphics Channel */
	XAVBuf_EnableGraphicsBuffers(RunCfgPtr->AVBufPtr, 1);
	/* Set the output Video Format */
	XAVBuf_SetOutputVideoFormat(AVBufPtr, RGB_8BPC);

	/* Select the Input Video Sources.
	 * non-live graphics overlay mode (DDR framebuffer)
	 */
	XAVBuf_InputVideoSelect(AVBufPtr, XAVBUF_VIDSTREAM1_NONE,
							XAVBUF_VIDSTREAM2_NONLIVE_GFX);
	/* Configure Video pipeline for graphics channel */
	XAVBuf_ConfigureGraphicsPipeline(AVBufPtr);
	/* Configure the output video pipeline */
	XAVBuf_ConfigureOutputVideo(AVBufPtr);
	/* Disable the global alpha, since we are using the pixel based alpha */
	XAVBuf_SetBlenderAlpha(AVBufPtr, 0, 0);
	/* Set the clock mode */
	XDpPsu_CfgMsaEnSynchClkMode(DpPsuPtr, RunCfgPtr->EnSynchClkMode);
	/* Set the clock source depending on the use case.
	 * Here for simplicity we are using PS clock as the source*/
	XAVBuf_SetAudioVideoClkSrc(AVBufPtr, XAVBUF_PS_CLK, XAVBUF_PS_CLK);
	/* Issue a soft reset after selecting the input clock sources */
	XAVBuf_SoftReset(AVBufPtr);

	return XST_SUCCESS;
}

/*****************************************************************************/
/**
*
* The purpose of this function is to setup call back functions for the DP
* controller interrupts.
*
******************************************************************************/
void SetupInterrupts(Run_Config *RunCfgPtr)
{
	XDpPsu *DpPsuPtr = RunCfgPtr->DpPsuPtr;
	XScuGic		*IntrPtr = RunCfgPtr->IntrPtr;
	XScuGic_Config	*IntrCfgPtr;
	u32  IntrMask = XDPPSU_INTR_HPD_IRQ_MASK | XDPPSU_INTR_HPD_EVENT_MASK;

	XDpPsu_WriteReg(DpPsuPtr->Config.BaseAddr, XDPPSU_INTR_DIS, 0xFFFFFFFF);
	XDpPsu_WriteReg(DpPsuPtr->Config.BaseAddr, XDPPSU_INTR_MASK, 0xFFFFFFFF);

	XDpPsu_SetHpdEventHandler(DpPsuPtr, DpPsu_IsrHpdEvent, RunCfgPtr);
	XDpPsu_SetHpdPulseHandler(DpPsuPtr, DpPsu_IsrHpdPulse, RunCfgPtr);

#ifndef SDT
	/* Initialize interrupt controller driver. */
	IntrCfgPtr = XScuGic_LookupConfig(INTC_DEVICE_ID);
	XScuGic_CfgInitialize(IntrPtr, IntrCfgPtr, IntrCfgPtr->CpuBaseAddress);

	/* Register ISRs. */
	XScuGic_Connect(IntrPtr, DPPSU_INTR_ID,
			(Xil_InterruptHandler)XDpPsu_HpdInterruptHandler, RunCfgPtr->DpPsuPtr);

	/* Trigger DP interrupts on rising edge. */
	XScuGic_SetPriorityTriggerType(IntrPtr, DPPSU_INTR_ID, 0x0, 0x03);


	/* Connect DPDMA Interrupt */
	XScuGic_Connect(IntrPtr, DPDMA_INTR_ID,
			(Xil_ExceptionHandler)XDpDma_InterruptHandler, RunCfgPtr->DpDmaPtr);

	/* Initialize exceptions. */
	Xil_ExceptionInit();
	Xil_ExceptionRegisterHandler(XIL_EXCEPTION_ID_IRQ_INT,
			(Xil_ExceptionHandler)XScuGic_DeviceInterruptHandler,
			INTC_DEVICE_ID);

	/* Enable exceptions for interrupts. */
	Xil_ExceptionEnableMask(XIL_EXCEPTION_IRQ);
	Xil_ExceptionEnable();

	/* Enable DP interrupts. */
	XScuGic_Enable(IntrPtr, DPPSU_INTR_ID);
	XDpPsu_WriteReg(DpPsuPtr->Config.BaseAddr, XDPPSU_INTR_EN, IntrMask);

	/* Enable DPDMA Interrupts */
	XScuGic_Enable(IntrPtr, DPDMA_INTR_ID);
	XDpDma_InterruptEnable(RunCfgPtr->DpDmaPtr, XDPDMA_IEN_VSYNC_INT_MASK);
#else
    XSetupInterruptSystem(RunCfgPtr->DpPsuPtr, &XDpPsu_HpdInterruptHandler, RunCfgPtr->DpPsuPtr->Config.IntrId,
            RunCfgPtr->DpPsuPtr->Config.IntrParent, XINTERRUPT_DEFAULT_PRIORITY);
	XDpPsu_WriteReg(DpPsuPtr->Config.BaseAddr, XDPPSU_INTR_EN, IntrMask);
    XSetupInterruptSystem(RunCfgPtr->DpDmaPtr, &XDpDma_InterruptHandler, RunCfgPtr->DpDmaPtr->Config.IntrId,
            RunCfgPtr->DpDmaPtr->Config.IntrParent, XINTERRUPT_DEFAULT_PRIORITY);
	XDpDma_InterruptEnable(RunCfgPtr->DpDmaPtr, XDPDMA_IEN_VSYNC_INT_MASK);
#endif
}

/*****************************************************************************/
/**
*
* GraphicsOverlay - 画面を黒でクリアする
*
* 公式サンプルではカラーバー（上半分赤/下半分緑）を描画していたが、
* シリアル受信版では黒画面に変更。fbポインタも初期化する。
*
******************************************************************************/
u8 *GraphicsOverlay(u8* Frame, Run_Config *RunCfgPtr)
{
	/* fbポインタをFrame配列に設定（以降のfb_*関数で使用） */
	fb = (u32 *)Frame;

	/* 画面全体を黒でクリア */
	fb_clear();

	return Frame;
}
